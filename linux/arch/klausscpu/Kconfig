## linux/arch/klausscpu/Kconfig
```kconfig
# SPDX-License-Identifier: GPL-2.0
#
# KlaussCPU: 64-bit registers, 32-bit addresses, software-refilled TLB with
# 64 KiB pages (klaussCPU MMU_PLAN.md §11).  See LINUX_PLAN.md.
#

config KLAUSSCPU
	def_bool y
	select ARCH_HAS_PTE_SPECIAL
	select ARCH_STACKWALK
	select BUILDTIME_TABLE_SORT
	select ARCH_WANT_FRAME_POINTERS
	select GENERIC_ENTRY
	select HAVE_GENERIC_TIF_BITS
	select HAVE_SYSCALL_TRACEPOINTS
	select GENERIC_CLOCKEVENTS
	select GENERIC_CPU_DEVICES
	select GENERIC_IOREMAP
	select GENERIC_IRQ_PROBE
	select GENERIC_IRQ_SHOW
	select GENERIC_LIB_ASHLDI3
	select GENERIC_LIB_ASHRDI3
	select GENERIC_LIB_LSHRDI3
	select GENERIC_SMP_IDLE_THREAD
	select GENERIC_STRNCPY_FROM_USER
	select GENERIC_STRNLEN_USER
	select HAVE_PAGE_SIZE_64KB
	select HVC_DRIVER
	select IRQ_DOMAIN
	select LOCK_MM_AND_FIND_VMA
	select MMU_GATHER_NO_RANGE
	select MODULES_USE_ELF_RELA
	select SPARSE_IRQ
	select THREAD_INFO_IN_TASK
	select TRACE_IRQFLAGS_SUPPORT

config 64BIT
	def_bool y

config MMU
	def_bool y

config NR_CPUS
	int
	default 1

config PGTABLE_LEVELS
	int
	default 2

config GENERIC_HWEIGHT
	def_bool y

config GENERIC_CALIBRATE_DELAY
	def_bool y

config GENERIC_CSUM
	def_bool y

config GENERIC_BUG
	def_bool y
	depends on BUG

config STACKTRACE_SUPPORT
	def_bool y

config NO_IOPORT_MAP
	def_bool y

config ARCH_MMAP_RND_BITS_MIN
	default 8

config ARCH_MMAP_RND_BITS_MAX
	default 12

menu "KlaussCPU platform"

config KLAUSSCPU_DDR_SIZE
	hex "DDR size"
	default 0x08000000
	help
	  Physical memory at PA 0 (128 MiB on the Nexys A7).  All of it is
	  lowmem in kseg (0x8000_0000 + PA).

config KLAUSSCPU_CPU_HZ
	int "Core clock in Hz"
	default 100000000
	help
	  The CYCLE system register counts at this rate; it is the
	  clocksource and sched_clock.

config KLAUSSCPU_TIMER_HZ
	int "Interval timer input clock in Hz"
	default 100000000

config CMDLINE
	string "Built-in kernel command line"
	default "console=hvc0"
	help
	  The klausscc loader passes no command line; this is it.

config KLAUSSCPU_SD
	bool "SD card (SPI-mode controller) as mmcblk0"
	depends on BLOCK
	default y
	help
	  The board's SD card slot.  Polled; the probe finds nothing on an
	  emulator without the controller.

config KLAUSSCPU_ETH
	bool "LiteEth Ethernet (eth0)"
	depends on NET
	default y
	help
	  The board's LiteEth MAC and LAN8720A PHY.  The probe finds nothing
	  on an emulator without the MAC.

config KLAUSSCPU_TRNG
	bool "TRNG as a hardware random source"
	depends on HW_RANDOM
	default y

config KLAUSSCPU_EARLY_UART
	bool "Early console on the polled UART"
	default y

endmenu

source "kernel/Kconfig.hz"
```

## linux/arch/klausscpu/configs/defconfig
```kconfig
# KlaussCPU: emulator and Nexys A7 (stage 3 release bitstream), UP, no DT.
CONFIG_SYSVIPC=y
CONFIG_NO_HZ_IDLE=y
CONFIG_HIGH_RES_TIMERS=y
CONFIG_BLK_DEV_INITRD=y
CONFIG_INITRAMFS_SOURCE="initramfs.list"
# CONFIG_RD_BZIP2 is not set
# CONFIG_RD_LZMA is not set
# CONFIG_RD_XZ is not set
# CONFIG_RD_LZO is not set
# CONFIG_RD_LZ4 is not set
# CONFIG_RD_ZSTD is not set
CONFIG_CC_OPTIMIZE_FOR_SIZE=y
CONFIG_EXPERT=y
# CONFIG_SYSFS_SYSCALL is not set
# CONFIG_FHANDLE is not set
CONFIG_KALLSYMS=y
# CONFIG_IO_URING is not set
# CONFIG_ADVISE_SYSCALLS is not set
# CONFIG_MEMBARRIER is not set
# CONFIG_RSEQ is not set
CONFIG_EMBEDDED=y
# CONFIG_VM_EVENT_COUNTERS is not set
# CONFIG_COMPAT_BRK is not set
# CONFIG_SWAP is not set
CONFIG_MSDOS_PARTITION=y
CONFIG_VFAT_FS=y
CONFIG_FAT_DEFAULT_UTF8=y
CONFIG_NLS_CODEPAGE_437=y
CONFIG_NLS_ISO8859_1=y
CONFIG_NLS_UTF8=y
# CONFIG_MODULES is not set
CONFIG_BINFMT_ELF=y
CONFIG_BINFMT_SCRIPT=y
# CONFIG_COREDUMP is not set
CONFIG_UEVENT_HELPER=y
CONFIG_DEVTMPFS=y
CONFIG_DEVTMPFS_MOUNT=y
# CONFIG_FW_LOADER is not set
# CONFIG_INPUT is not set
# CONFIG_SERIO is not set
# CONFIG_VT is not set
# CONFIG_LEGACY_PTYS is not set
CONFIG_HW_RANDOM=y
# CONFIG_HWMON is not set
# CONFIG_USB_SUPPORT is not set
CONFIG_NETDEVICES=y
# CONFIG_ETHERNET is not set
# CONFIG_WLAN is not set
CONFIG_NET=y
CONFIG_PACKET=y
CONFIG_UNIX=y
CONFIG_INET=y
# CONFIG_IPV6 is not set
# CONFIG_WIRELESS is not set
# CONFIG_ETHTOOL_NETLINK is not set
CONFIG_TMPFS=y
# CONFIG_MISC_FILESYSTEMS is not set
CONFIG_PRINTK_TIME=y
# klausscpu-llvm's clang 23 snapshot lacks the capability attributes on
# function-pointer parameters that blkdev.h uses with this on.
# CONFIG_WARN_CONTEXT_ANALYSIS is not set
CONFIG_CMDLINE="console=hvc0 rdinit=/init"
```

## linux/buildroot/external/configs/klausscpu_defconfig
```kconfig
# KlaussCPU: packages for the system image (linux/buildroot/build.sh).
# No kernel, bootloader, init or busybox: linux/build.sh and our own
# initramfs/rcS do those; build-rootfs.sh merges output/images/rootfs.tar
# into the system image (ROOTFS_BUILDROOT=1).
BR2_klausscpu=y
BR2_DL_DIR="$(KLAUSSCPU_WS)/br-dl"
BR2_TOOLCHAIN_EXTERNAL=y
BR2_TOOLCHAIN_EXTERNAL_CUSTOM=y
BR2_TOOLCHAIN_EXTERNAL_PREINSTALLED=y
BR2_TOOLCHAIN_EXTERNAL_PATH="$(KLAUSSCPU_WS)/br-toolchain"
BR2_TOOLCHAIN_EXTERNAL_CUSTOM_PREFIX="klausscpu-linux-musl"
BR2_TOOLCHAIN_EXTERNAL_GCC_14=y
BR2_TOOLCHAIN_EXTERNAL_HEADERS_6_19=y
BR2_TOOLCHAIN_EXTERNAL_CUSTOM_MUSL=y
# BR2_TOOLCHAIN_EXTERNAL_CXX is not set
BR2_STATIC_LIBS=y
BR2_SSP_NONE=y
BR2_INIT_NONE=y
BR2_SYSTEM_BIN_SH_NONE=y
# BR2_TARGET_GENERIC_GETTY is not set
# BR2_PACKAGE_BUSYBOX is not set
BR2_TARGET_ROOTFS_TAR=y
# BR2_TARGET_ROOTFS_TAR_GZIP is not set
BR2_PACKAGE_ZLIB=y
BR2_PACKAGE_NCURSES=y
BR2_PACKAGE_NCURSES_TARGET_PROGS=y
BR2_PACKAGE_NANO=y
BR2_PACKAGE_FILE=y
BR2_PACKAGE_LESS=y
BR2_PACKAGE_TREE=y
BR2_PACKAGE_JQ=y
BR2_PACKAGE_HTOP=y
BR2_PACKAGE_TMUX=y
BR2_GLOBAL_PATCH_DIR="$(BR2_EXTERNAL_KLAUSSCPU_PATH)/patches"
BR2_PACKAGE_STRACE=y
# Development and test tools (2026-11-11).
BR2_PACKAGE_BASH=y
BR2_PACKAGE_BC=y
BR2_PACKAGE_GAWK=y
BR2_PACKAGE_DIFFUTILS=y
BR2_PACKAGE_MAKE=y
BR2_PACKAGE_VIM=y
BR2_PACKAGE_NCDU=y
BR2_PACKAGE_DOS2UNIX=y
BR2_PACKAGE_XZ=y
BR2_PACKAGE_BZIP2=y
BR2_PACKAGE_ZSTD=y
BR2_PACKAGE_RSYNC=y
BR2_PACKAGE_E2FSPROGS=y
BR2_PACKAGE_E2FSPROGS_DEBUGFS=y
BR2_PACKAGE_E2FSPROGS_RESIZE2FS=y
BR2_PACKAGE_DOSFSTOOLS=y
BR2_PACKAGE_DOSFSTOOLS_FSCK_FAT=y
BR2_PACKAGE_DOSFSTOOLS_MKFS_FAT=y
BR2_PACKAGE_PROCPS_NG=y
BR2_PACKAGE_PSMISC=y
BR2_PACKAGE_LSOF=y
BR2_PACKAGE_SYSSTAT=y
BR2_PACKAGE_IPROUTE2=y
BR2_PACKAGE_TCPDUMP=y
BR2_PACKAGE_SOCAT=y
BR2_PACKAGE_ETHTOOL=y
BR2_PACKAGE_STRESS_NG=y
BR2_PACKAGE_MEMTESTER=y
BR2_PACKAGE_DHRYSTONE=y
BR2_PACKAGE_WHETSTONE=y
BR2_PACKAGE_GIT=y
BR2_PACKAGE_LIBCURL=y
BR2_PACKAGE_OPENSSL=y
# OpenSSL's 64-bit C P-256 (needs __int128, little-endian): an OpenSSH login
# 4.42 -> 3.12 s on the board (LINUX_PLAN "SSH servers").  no-asm: no
# assembly for KlaussCPU.
BR2_PACKAGE_LIBOPENSSL_TARGET_ARCH="linux-generic64 no-asm enable-ec_nistp_64_gcc_128"
BR2_PACKAGE_OPENSSH=y
BR2_PACKAGE_OPENSSH_CLIENT=y
BR2_PACKAGE_OPENSSH_SERVER=y
BR2_PACKAGE_OPENSSH_KEY_UTILS=y
BR2_PACKAGE_SUDO=y
BR2_PACKAGE_UTIL_LINUX=y
BR2_PACKAGE_UTIL_LINUX_BINARIES=y
BR2_PACKAGE_MC=y
```

## zephyr-ws/klausscpu-zephyr/boards/klausscpu/nexys_a7/board.yml
```yaml
board:
  name: nexys_a7
  full_name: KlaussCPU on Digilent Nexys A7
  socs:
    - name: klausscpu_nexys_a7
```

## zephyr-ws/klausscpu-zephyr/drivers/crypto/Kconfig
```kconfig
config PSA_CRYPTO_DRIVER_KLAUSSCPU
	bool "KlaussCPU crypto block as a PSA accelerator driver"
	default y
	depends on MBEDTLS
	help
	  SHA-256 (and with it HMAC-SHA-256) for TF-PSA-Crypto on the
	  KlaussCPU SHA block, when the bitstream has state save/restore.
	  Needs zephyr-patches/tf-psa-crypto-klausscpu.patch.
```

## zephyr-ws/klausscpu-zephyr/drivers/entropy/Kconfig
```kconfig
config ENTROPY_KLAUSSCPU_TRNG
	bool "KlaussCPU TRNG entropy driver"
	default y
	depends on DT_HAS_KLAUSSCPU_TRNG_ENABLED
	depends on ENTROPY_GENERATOR
	select ENTROPY_HAS_DRIVER
	help
	  Zephyr entropy driver for the KlaussCPU TRNG (0xF00C_0000).  With it
	  chosen as zephyr,entropy, sys_rand/sys_csrand and mbedTLS take their
	  randomness from the hardware instead of a test generator.
```

## zephyr-ws/klausscpu-zephyr/drivers/ethernet/Kconfig
```kconfig
config ETH_KLAUSSCPU
	bool "KlaussCPU LiteEth Ethernet driver"
	default n
	depends on NET_L2_ETHERNET
	help
	  Ethernet driver for the KlaussCPU LiteEth MAC on Nexys A7.
	  Uses polled RX (no IRQ) and blocking TX via MMIO slot SRAM.

if ETH_KLAUSSCPU

config ETH_KLAUSSCPU_RX_STACK_SIZE
	int "RX polling thread stack size"
	default 4096

config ETH_KLAUSSCPU_RX_PRIO
	int "RX polling thread priority"
	default 2

config ETH_KLAUSSCPU_INIT_PRIORITY
	int "Init priority"
	default 80

config ETH_KLAUSSCPU_LOG_LEVEL
	int "Log level (0=OFF, 1=ERR, 2=WRN, 3=INF, 4=DBG)"
	default 3
	range 0 4

config ETH_KLAUSSCPU_WIDE_SRAM
	bool "Copy frames to/from slot SRAM 32 bits at a time"
	default y
	help
	  Copy the aligned middle of each frame between normal memory and the
	  MAC's slot SRAM with 32-bit accesses instead of one byte at a time
	  (byte head/tail still handle the unaligned edges).

	  The byte-wise loop it replaces was never a hardware requirement — it
	  exists only because memcpy() will not accept a volatile pointer.  But
	  volatile also stops the compiler coalescing the accesses, so each byte
	  becomes its own uncached MMIO bus transaction: ~4x more round trips than
	  necessary, which dominates the TX path on full-frame streams (e.g. VNC).

	  Set n to restore the byte-at-a-time loop.  Do that if frames stop
	  egressing or arrive corrupted, which would mean the slot SRAM does not
	  decode 32-bit accesses — this MAC has form for such quirks (it transmits
	  reliably only from slot 0), and only the CSR registers are documented as
	  32-bit.  The failure mode is loud: no traffic at all.

endif # ETH_KLAUSSCPU
```

## zephyr-ws/klausscpu-zephyr/drivers/flash/Kconfig
```kconfig
config FLASH_KLAUSSCPU_QSPI
	bool "KlaussCPU QSPI configuration-flash driver"
	default y
	depends on DT_HAS_KLAUSSCPU_QSPI_FLASH_ENABLED
	depends on FLASH
	select FLASH_HAS_DRIVER_ENABLED
	select FLASH_HAS_PAGE_LAYOUT
	select FLASH_HAS_EXPLICIT_ERASE
	help
	  Flash driver for the board's S25FL128S configuration flash through
	  klaussCPU's qspi_ctrl (0xF012_0000).  Program and erase are allowed
	  only at or above the hardware floor (0xF0_0000); the FPGA bitstream
	  below it is read-only.  On a bitstream without qspi_ctrl the device
	  fails to initialise (not ready).
```

## zephyr-ws/klausscpu-zephyr/drivers/timer/Kconfig
```kconfig
config KLAUSSCPU_TIMER
	bool "KlaussCPU system timer"
	default n
	select TIMER_HAS_64BIT_CYCLE_COUNTER
	help
	  System tick timer for the KlaussCPU MMIO interrupt controller.
	  Fixed-rate (10 kHz @ 100 MHz CPU); does NOT support tickless —
	  sys_clock_set_timeout() is a no-op and sys_clock_elapsed() returns 0.
	  Do NOT select TICKLESS_CAPABLE here, or k_msleep / timeouts won't fire.
	  k_cycle_get_32/64() read the free-running PERF_CYCLES counter
	  (0xF00D_0008, 48-bit @ 100 MHz — wraps after ~32 days); a perf-counter
	  clear (PERF_CTRL[0]) zeroes it, invalidating in-flight cycle deltas.
```

## zephyr-ws/klausscpu-zephyr/dts/bindings/flash/klausscpu,qspi-flash.yaml
```yaml
description: |
  KlaussCPU qspi_ctrl: CPU access to the board's QSPI configuration flash
  (S25FL128S, 16 MiB).  The child soc-nv-flash node describes the flash
  (reg = <0 size>, erase-block-size, write-block-size) and its partitions.
  Offsets are flash byte addresses; program/erase below the hardware floor
  (0xF0_0000, the FPGA bitstream) are refused.

compatible: "klausscpu,qspi-flash"

include: [flash-controller.yaml]

properties:
  reg:
    required: true
```

## zephyr-ws/klausscpu-zephyr/dts/bindings/rng/klausscpu,trng.yaml
```yaml
description: |
  KlaussCPU true random number generator: ring oscillators, a conditioner and
  NIST SP 800-90B continuous health tests, read as 64-bit words from a FIFO.

compatible: "klausscpu,trng"

include: base.yaml

properties:
  reg:
    required: true
```

## zephyr-ws/klausscpu-zephyr/lib/libc_extras/Kconfig
```kconfig
config KLAUSSCPU_LIBC_EXTRAS
	bool "C library additions for minimal libc (setjmp, C99 math declarations)"
	depends on MINIMAL_LIBC
	help
	  Adds <alloca.h>, <unistd.h> (types only) and <setjmp.h> with setjmp/longjmp (src/setjmp.S, shared with the
	  bare-metal programs) and extends minimal libc's <math.h> with the C99
	  function declarations and classification macros.  The math functions
	  themselves are not provided here; the application links an
	  implementation (MicroPython: lib/libm_dbl).
```

## zephyr-ws/klausscpu-zephyr/soc/klausscpu/nexys_a7/Kconfig.soc
```kconfig
config SOC_KLAUSSCPU_NEXYS_A7
	bool
	select CPU_KLAUSSCPU

config SOC
	default "klausscpu_nexys_a7" if SOC_KLAUSSCPU_NEXYS_A7
```

## zephyr-ws/klausscpu-zephyr/ssh/Kconfig
```kconfig
config KLAUSSCPU_SSH_SERVER
	bool "KlaussCPU SSH server"
	default n
	depends on NET_SOCKETS
	depends on DISK_KLAUSSCPU_SD
	help
	  SSH server using wolfSSH over Zephyr sockets.
	  Requires wolfSSL and wolfSSH libraries to be available.
	  Provides an interactive shell with filesystem and hardware commands.

config KLAUSSCPU_HTTP_SERVER
	bool "KlaussCPU HTTP file server"
	default n
	depends on NET_SOCKETS
	depends on FILE_SYSTEM
	help
	  Minimal raw-socket HTTP/1.0 file server on port 80 serving the SD card
	  (/SD:): GET downloads files / lists directories, PUT uploads files.
	  No auth or TLS — intended for trusted LAN use.

config KLAUSSCPU_HTTPS_SERVER
	bool "KlaussCPU HTTPS file server"
	default n
	depends on NET_SOCKETS
	depends on FILE_SYSTEM
	depends on WOLFSSL
	help
	  HTTP-over-TLS file server on port 443 serving the SD card (/SD:),
	  reusing the HTTP request dispatch.  Presents a self-signed ECDSA
	  P-256 certificate, generated on first boot and persisted to the SD
	  card.  Supports TLS 1.2 and 1.3.  No client-certificate auth.

config KLAUSSCPU_HTTP_PUT
	bool "Accept uploads (PUT) on the HTTP and HTTPS file servers"
	depends on KLAUSSCPU_HTTP_SERVER || KLAUSSCPU_HTTPS_SERVER
	help
	  PUT /<path> writes the file with no login, so anyone who can reach
	  the board could replace any file on the card.  Off by default:
	  upload over SFTP instead.  The key folder (/SD:/sys) is refused
	  either way.

config KLAUSSCPU_SHELL_CMDS
	bool "KlaussCPU shell commands"
	default y if SHELL
	depends on SHELL
	depends on FILE_SYSTEM
	help
	  Register filesystem and hardware commands with the Zephyr shell.
	  Available on the UART console independently of the SSH server.

config KLAUSSCPU_PYTHON
	bool "python shell command (MicroPython)"
	depends on KLAUSSCPU_SSH_SERVER
	depends on KLAUSSCPU_SHELL_CMDS
	depends on FILE_SYSTEM
	select KLAUSSCPU_LIBC_EXTRAS
	help
	  MicroPython (modules/lib/micropython) as the `python` shell command:
	  a REPL on the session, or `python file.py [args]` from the SD card
	  (micropython/ssh, MICROPYTHON_PLAN.md).

config KLAUSSCPU_PYTHON_HEAP_SIZE
	int "MicroPython GC heap size (bytes)"
	depends on KLAUSSCPU_PYTHON
	default 1048576
	help
	  A static buffer, used by one session at a time.
```
