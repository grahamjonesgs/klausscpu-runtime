## CMakeLists.txt
```
cmake_minimum_required(VERSION 3.20)

find_package(Zephyr REQUIRED HINTS $ENV{ZEPHYR_BASE})
project(doom)

set(DG ${CMAKE_CURRENT_SOURCE_DIR}/doomgeneric-src/doomgeneric)

if(NOT EXISTS ${DG}/doomgeneric.c)
  message(FATAL_ERROR
    "doomgeneric sources not found. Run apps/doom/fetch-doomgeneric.sh first.")
endif()

# Our fixes to the fetched engine (patches/*.patch, git-apply format), applied
# once at configure time: a patch whose reverse already applies is in place.
#   0001: 64-bit game timer — stock Doom froze after ~17 h of uptime.
file(GLOB DOOM_PATCHES ${CMAKE_CURRENT_SOURCE_DIR}/patches/*.patch)
list(SORT DOOM_PATCHES)
foreach(p ${DOOM_PATCHES})
  execute_process(COMMAND git apply --reverse --check ${p}
    WORKING_DIRECTORY ${CMAKE_CURRENT_SOURCE_DIR}/doomgeneric-src
    RESULT_VARIABLE already OUTPUT_QUIET ERROR_QUIET)
  if(NOT already EQUAL 0)
    execute_process(COMMAND git apply ${p}
      WORKING_DIRECTORY ${CMAKE_CURRENT_SOURCE_DIR}/doomgeneric-src
      RESULT_VARIABLE rc)
    if(NOT rc EQUAL 0)
      message(FATAL_ERROR "doom: failed to apply ${p} to doomgeneric-src")
    endif()
    message(STATUS "doom: applied ${p}")
  endif()
endforeach()

# Doom engine sources (the bare-metal "soso" set: no SDL, generic dummy sound),
# minus its platform backend (doomgeneric_soso.c) which we replace with our own.
set(DOOM_SRCS
  am_map doomdef doomstat dstrings d_event d_items d_iwad d_loop d_main d_mode
  d_net f_finale f_wipe g_game hu_lib hu_stuff info i_cdmus i_endoom i_joystick
  i_scale i_sound i_system i_timer memio m_argv m_bbox m_cheat m_config
  m_controls m_fixed m_menu m_misc m_random p_ceilng p_doors p_enemy p_floor
  p_inter p_lights p_map p_maputl p_mobj p_plats p_pspr p_saveg p_setup p_sight
  p_spec p_switch p_telept p_tick p_user r_bsp r_data r_draw r_main r_plane
  r_segs r_sky r_things sha1 sounds statdump st_lib st_stuff s_sound tables
  v_video wi_stuff w_checksum w_file w_main w_wad z_zone w_file_stdc i_input
  i_video doomgeneric dummy)

set(ENGINE_SOURCES "")
foreach(s ${DOOM_SRCS})
  list(APPEND ENGINE_SOURCES ${DG}/${s}.c)
endforeach()

target_sources(app PRIVATE
  ${ENGINE_SOURCES}
  src/doomgeneric_zephyr.c
  src/zephyr_stdio.c
  src/compat.c
)

# compat/ provides the POSIX headers minimal libc lacks (unistd.h, sys/stat.h,
# ...).  Engine sources include them as <...>, so it must precede the system
# include dirs — SYSTEM keeps clang from warning on the stub headers.
target_include_directories(app BEFORE PRIVATE ${DG} compat)

# Render at Doom's native 320x200 (no software 2x upscale).  Quarters the
# render, convert and VNC-send work vs the default 640x400; the VNC client
# scales it up for display.
target_compile_definitions(app PRIVATE DOOMGENERIC_RESX=320 DOOMGENERIC_RESY=200)

# Hand frames over as Doom's native 8-bit palette indices (doomgeneric's
# CMAP256 mode): I_FinishUpdate is then a 64 KB memcpy instead of a per-pixel
# palette -> XRGB8888 expansion (256 KB written), and DG_DrawFrame maps index ->
# RGB565 through a 256-entry table rebuilt when the palette changes.
target_compile_definitions(app PRIVATE CMAP256)

# Doom is full of intentional old-C idioms; silence its warnings rather than
# patch vendored sources, and force-include our stdio shim so the file
# functions minimal libc lacks (fopen/fread/...) have correct prototypes.
set_source_files_properties(${ENGINE_SOURCES} PROPERTIES COMPILE_FLAGS
  "-w -include ${CMAKE_CURRENT_SOURCE_DIR}/src/zephyr_stdio.h")
```

## Kconfig
```
# Doom app Kconfig.  An application Kconfig must source the rest of Zephyr's.

config DOOM_PROFILE
	bool "Profile the Doom frame pipeline"
	default n
	help
	  Print periodic per-frame timing to the console: fps and average
	  tick / convert / render (= tick - convert) milliseconds.  Pair with
	  KLAUSSCPU_VNC_PROFILE to see the send side.  Diagnostic only.

source "Kconfig.zephyr"
```

## prj.conf
```kconfig
# ── Core ──────────────────────────────────────────────────────────────────
CONFIG_XIP=n
CONFIG_CBPRINTF_FP_SUPPORT=n
CONFIG_CBPRINTF_FP_A_SUPPORT=n
# Also emit a debug-stripped zephyr.strip (the full zephyr.elf carries ~tens of
# MB of DWARF that never reaches the board; the loaded image is ~1 MB).
CONFIG_BUILD_OUTPUT_STRIPPED=y

# ── UART console (Doom prints status via printf/puts) ─────────────────────
CONFIG_UART_KLAUSSCPU=y
CONFIG_UART_CONSOLE=y
CONFIG_CONSOLE=y
CONFIG_PRINTK=y

# ── Timer (1 kHz tick, matches ssh_shell rationale for the eth RX poll) ───
CONFIG_KLAUSSCPU_TIMER=y
CONFIG_SYS_CLOCK_HW_CYCLES_PER_SEC=100000000
CONFIG_SYS_CLOCK_TICKS_PER_SEC=1000

# ── Networking (for the VNC link) ─────────────────────────────────────────
CONFIG_NETWORKING=y
CONFIG_NET_L2_ETHERNET=y
CONFIG_ETH_KLAUSSCPU=y
CONFIG_NET_IPV4=y
CONFIG_NET_IPV6=n
CONFIG_NET_DHCPV4=y
CONFIG_NET_SOCKETS=y
CONFIG_NET_TCP=y
CONFIG_NET_UDP=y
# TCP windows: the default (0) leaves a tiny send window, so VNC frames go out
# nearly one segment at a time, each waiting a full ACK round-trip (~3.4 s for a
# 512 KB frame).  A 32 KB window (fits the 16-bit window field, no scaling) lets
# TCP pipeline many segments before waiting -> ~10x+ throughput.
CONFIG_NET_TCP_MAX_SEND_WINDOW_SIZE=32768
CONFIG_NET_TCP_MAX_RECV_WINDOW_SIZE=32768
# 64-bit pointers/longs make every net stack frame larger; give the net threads
# real headroom (same rationale as ssh_shell) and keep the sentinel on.
CONFIG_NET_RX_STACK_SIZE=8192
CONFIG_NET_TX_STACK_SIZE=8192
CONFIG_NET_SOCKETS_SERVICE_STACK_SIZE=8192
CONFIG_NET_MGMT_EVENT_STACK_SIZE=8192
CONFIG_NET_TCP_WORKQ_STACK_SIZE=8192
CONFIG_STACK_SENTINEL=y
# Known-good buffer counts (this set connected and rendered the splash).  An
# aggressive 4-8x bump broke the handshake, so stay here; the frame-rate cap
# below is the lever for the RX-pkt-exhaustion flood instead.
CONFIG_NET_PKT_RX_COUNT=64
CONFIG_NET_PKT_TX_COUNT=48
CONFIG_NET_BUF_RX_COUNT=96
CONFIG_NET_BUF_TX_COUNT=64
CONFIG_NET_BUF_DATA_SIZE=1536
CONFIG_NET_MAX_CONTEXTS=24
CONFIG_NET_MAX_CONN=24
CONFIG_ZVFS_OPEN_MAX=16

# ── SD card + filesystem (the WAD lives at /SD:/doom1.wad) ────────────────
CONFIG_DISK_ACCESS=y
CONFIG_DISK_KLAUSSCPU_SD=y
CONFIG_FILE_SYSTEM=y
CONFIG_FAT_FILESYSTEM_ELM=y
CONFIG_FS_FATFS_LFN=y
# HEAP, not BSS: FS_FATFS_REENTRANT depends on !FS_FATFS_LFN_MODE_BSS.
CONFIG_FS_FATFS_LFN_MODE_HEAP=y
CONFIG_FS_FATFS_REENTRANT=y

# ── VNC (RFB) server — the display.  Doom owns the framebuffer, so disable
#    the built-in demo (test pattern + bouncing box). ──────────────────────
CONFIG_KLAUSSCPU_VNC_SERVER=y
CONFIG_KLAUSSCPU_VNC_DEMO=n
# Match the framebuffer to Doom's native 320x200 instead of centring inside
# 640x480: the client scales it up, and every full-frame update is now one
# contiguous block, so the native-format send path is zero-copy (no staging
# copy, no blit, no cache walks) — PERFORMANCE.md lever 3.
CONFIG_KLAUSSCPU_VNC_FB_WIDTH=320
CONFIG_KLAUSSCPU_VNC_FB_HEIGHT=200
# Offload the send-path framebuffer->sendbuf copy (the "vnc: convert=..ms" line)
# to the 2D DMA blitter, freeing that CPU time for Doom's tick.  A/B knob: set n
# to force the memcpy baseline and compare the convert= figure.  With the
# zero-copy path above this only covers partial-width dirty rects.
CONFIG_KLAUSSCPU_VNC_BLIT_SEND=y

# Step-0 pipeline instrumentation (render/convert/send/throughput to UART).
# Turn both off once we've read the numbers.
CONFIG_DOOM_PROFILE=y
CONFIG_KLAUSSCPU_VNC_PROFILE=y

# ── Logging (the VNC module uses the log subsystem) ───────────────────────
CONFIG_LOG=y
CONFIG_LOG_BACKEND_UART=y
CONFIG_THREAD_NAME=y
# Immediate mode: format at the call site instead of packaging args for a log
# thread.  Avoids the deferred-packaging vararg corruption seen on this 64-bit
# arch (garbled multi-arg lines) and removes the log-thread stack concern.
CONFIG_LOG_MODE_IMMEDIATE=y

# ── Memory ────────────────────────────────────────────────────────────────
# malloc arena = -1: instead of a fixed static array (which the KlaussCPU
# linker would materialise in the image, since its single LOAD segment has
# FileSiz == MemSiz), use all RAM from _end up to _heap_sentry at runtime.  So
# Doom's 16 MiB zone + 1 MiB screen come from the board's ~127 MiB of free RAM
# and cost no image/file space.
CONFIG_COMMON_LIBC_MALLOC_ARENA_SIZE=-1
CONFIG_HEAP_MEM_POOL_SIZE=524288
# Word-wise memcpy/memset/strings: the size-optimised minimal libc versions
# are byte-at-a-time, and Doom calls them constantly (zone, screen, wipes).
CONFIG_MINIMAL_LIBC_OPTIMIZE_STRING_FOR_SIZE=n
# main runs mount + DHCP (net_mgmt frames are large on this 64-bit core); the
# 16 KiB I tried first overflowed into a wild jump.  Match ssh_shell's 32 KiB.
CONFIG_MAIN_STACK_SIZE=32768
CONFIG_SYSTEM_WORKQUEUE_STACK_SIZE=8192

# KlaussCPU VGA port: also show the framebuffer on a monitor (KlaussCPU VGA_PLAN.md).
CONFIG_KLAUSSCPU_VGA=y
```

## amp.conf
```kconfig
# Doom with VNC served by AMP core 2 (AMP_CORE2_PLAN.md P4b).
# Build:  west build ... apps/doom --build-dir build_doom_amp -- -DEXTRA_CONF_FILE=amp.conf <usual -D...>
# Networking is OFF on this core (core 2 owns the LiteEth and runs lwIP);
# the Kconfig warnings about NET_* symbols from prj.conf are expected.
CONFIG_NETWORKING=n
CONFIG_NET_L2_ETHERNET=n
CONFIG_ETH_KLAUSSCPU=n
CONFIG_KLAUSSCPU_VNC_SERVER=n
CONFIG_KLAUSSCPU_VNC_BLIT_SEND=n
CONFIG_KLAUSSCPU_VNC_PROFILE=n
CONFIG_KLAUSSCPU_AMP_VNC=y
CONFIG_KLAUSSCPU_FRAMEBUFFER=y
CONFIG_KLAUSSCPU_VNC_FB_WIDTH=320
CONFIG_KLAUSSCPU_VNC_FB_HEIGHT=200
```

## vga.conf
```kconfig
# Doom on the KlaussCPU VGA port only (no VNC, no networking): the fastest
# configuration — Doom's 8-bit frames go straight to the VGA's palette mode,
# double-buffered and flipped at vblank, with no RGB565 conversion.
# Build:  west build ... apps/doom --build-dir build_doom_vga -- -DEXTRA_CONF_FILE=vga.conf <usual -D...>
# No VNC means no keyboard: Doom runs its attract-mode demos.  To play, use
# VNC with the VGA mirror instead (prj.conf, which already sets CONFIG_KLAUSSCPU_VGA=y).
# The Kconfig warnings about NET_* symbols from prj.conf are expected.
CONFIG_NETWORKING=n
CONFIG_NET_L2_ETHERNET=n
CONFIG_ETH_KLAUSSCPU=n
CONFIG_KLAUSSCPU_VNC_SERVER=n
CONFIG_KLAUSSCPU_VNC_BLIT_SEND=n
CONFIG_KLAUSSCPU_VNC_PROFILE=n
CONFIG_KLAUSSCPU_VGA=y
CONFIG_KLAUSSCPU_VNC_FB_WIDTH=320
CONFIG_KLAUSSCPU_VNC_FB_HEIGHT=200
```

## src/compat.c
```c
/*
 * compat.c — small POSIX stubs the Doom engine references but minimal libc
 * doesn't provide.  Most are only on code paths we don't exercise (IWAD
 * directory search, raw-tty handling, mmap WAD loading); access()/stat() are
 * implemented via the fopen shim so file-existence/size checks work, and
 * usleep/gettimeofday map onto the Zephyr clock.
 *
 * Zephyr's <kernel.h> is included first so ssize_t/off_t come from Zephyr; the
 * compat headers re-typedef them identically (-Wno-typedef-redefinition).
 */

#include <zephyr/kernel.h>
#include <stddef.h>
#include <stdarg.h>
#include <stdlib.h>
#include <ctype.h>

#include <unistd.h>
#include <fcntl.h>
#include <dirent.h>
#include <termios.h>
#include <sys/stat.h>
#include <sys/time.h>
#include <sys/ioctl.h>
#include <sys/mman.h>

#include "zephyr_stdio.h"   /* fopen/fseek/ftell/fclose/remove */

int isatty(int fd)
{
	ARG_UNUSED(fd);
	return 0;
}

int usleep(unsigned long usec)
{
	k_usleep((int32_t)usec);
	return 0;
}

unsigned sleep(unsigned sec)
{
	k_sleep(K_SECONDS(sec));
	return 0;
}

int gettimeofday(struct timeval *tv, void *tz)
{
	ARG_UNUSED(tz);
	if (tv) {
		int64_t ms = k_uptime_get();

		tv->tv_sec = (long)(ms / 1000);
		tv->tv_usec = (long)((ms % 1000) * 1000);
	}
	return 0;
}

int access(const char *path, int mode)
{
	ARG_UNUSED(mode);
	FILE *f = fopen(path, "rb");

	if (!f) {
		return -1;
	}
	fclose(f);
	return 0;
}

int stat(const char *path, struct stat *st)
{
	FILE *f = fopen(path, "rb");

	if (!f) {
		return -1;
	}
	fseek(f, 0, SEEK_END);
	if (st) {
		st->st_size = ftell(f);
		st->st_mode = S_IFREG;
	}
	fclose(f);
	return 0;
}

int fstat(int fd, struct stat *st)
{
	ARG_UNUSED(fd);
	ARG_UNUSED(st);
	return -1;
}

int unlink(const char *path)
{
	return remove(path);
}

int mkdir(const char *path, mode_t mode)
{
	ARG_UNUSED(path);
	ARG_UNUSED(mode);
	return 0;   /* pretend success (savegame/config dir) */
}

int getpid(void)
{
	return 1;
}

char *getcwd(char *buf, size_t size)
{
	if (buf && size >= 2) {
		buf[0] = '/';
		buf[1] = '\0';
		return buf;
	}
	return NULL;
}

DIR *opendir(const char *path)
{
	ARG_UNUSED(path);
	return NULL;   /* IWAD search only — bypassed via explicit -iwad */
}

struct dirent *readdir(DIR *d)
{
	ARG_UNUSED(d);
	return NULL;
}

int closedir(DIR *d)
{
	ARG_UNUSED(d);
	return 0;
}

int ioctl(int fd, unsigned long request, ...)
{
	ARG_UNUSED(fd);
	ARG_UNUSED(request);
	return -1;
}

int tcgetattr(int fd, struct termios *t)
{
	ARG_UNUSED(fd);
	ARG_UNUSED(t);
	return 0;
}

int tcsetattr(int fd, int actions, const struct termios *t)
{
	ARG_UNUSED(fd);
	ARG_UNUSED(actions);
	ARG_UNUSED(t);
	return 0;
}

void *mmap(void *addr, size_t len, int prot, int flags, int fd, off_t off)
{
	ARG_UNUSED(addr);
	ARG_UNUSED(len);
	ARG_UNUSED(prot);
	ARG_UNUSED(flags);
	ARG_UNUSED(fd);
	ARG_UNUSED(off);
	return MAP_FAILED;
}

int munmap(void *addr, size_t len)
{
	ARG_UNUSED(addr);
	ARG_UNUSED(len);
	return 0;
}

int system(const char *cmd)
{
	ARG_UNUSED(cmd);
	return -1;
}

/* ── libm subset (Doom calls these once, at renderer init) ───────────────── */

#define DG_PI      3.14159265358979323846
#define DG_HALF_PI 1.57079632679489661923
#define DG_TWO_PI  6.28318530717958647692

double fabs(double x)
{
	return __builtin_fabs(x);
}

double sin(double x)
{
	/* Range-reduce to [-pi, pi], then a 5-term Taylor series (accurate to
	 * ~1e-6 over the range — ample for building Doom's projection LUTs). */
	while (x > DG_PI) {
		x -= DG_TWO_PI;
	}
	while (x < -DG_PI) {
		x += DG_TWO_PI;
	}
	double x2 = x * x;

	return x * (1.0 - x2 / 6.0 *
		    (1.0 - x2 / 20.0 *
		     (1.0 - x2 / 42.0 *
		      (1.0 - x2 / 72.0))));
}

double cos(double x)
{
	return sin(x + DG_HALF_PI);
}

double tan(double x)
{
	return sin(x) / cos(x);
}

double atan(double x)
{
	int neg = 0, inv = 0;

	if (x < 0) {
		neg = 1;
		x = -x;
	}
	if (x > 1.0) {
		inv = 1;
		x = 1.0 / x;
	}
	double x2 = x * x;
	double r = x * (0.9998660 + x2 * (-0.3302995 + x2 * (0.1801410 +
		   x2 * (-0.0851330 + x2 * 0.0208351))));

	if (inv) {
		r = DG_HALF_PI - r;
	}
	return neg ? -r : r;
}

/* ── number parsing minimal libc lacks ──────────────────────────────────── */

double strtod(const char *s, char **end)
{
	while (isspace((unsigned char)*s)) {
		s++;
	}
	int sign = 1;

	if (*s == '+' || *s == '-') {
		sign = (*s == '-') ? -1 : 1;
		s++;
	}
	double val = 0.0;

	while (isdigit((unsigned char)*s)) {
		val = val * 10.0 + (*s - '0');
		s++;
	}
	if (*s == '.') {
		s++;
		double f = 0.1;

		while (isdigit((unsigned char)*s)) {
			val += (*s - '0') * f;
			f *= 0.1;
			s++;
		}
	}
	if (*s == 'e' || *s == 'E') {
		s++;
		int es = 1;

		if (*s == '+' || *s == '-') {
			es = (*s == '-') ? -1 : 1;
			s++;
		}
		int e = 0;

		while (isdigit((unsigned char)*s)) {
			e = e * 10 + (*s - '0');
			s++;
		}
		double p = 1.0;

		for (int i = 0; i < e; i++) {
			p *= 10.0;
		}
		val = (es < 0) ? val / p : val * p;
	}
	if (end) {
		*end = (char *)s;
	}
	return sign * val;
}

double atof(const char *s)
{
	return strtod(s, NULL);
}

/* Minimal sscanf — covers the integer/float/string conversions Doom uses
 * (%d %i %u %x %X %o %f %s %c and literal/whitespace matching). */
int sscanf(const char *str, const char *fmt, ...)
{
	va_list ap;
	const char *s = str;
	int count = 0;

	va_start(ap, fmt);
	for (const char *f = fmt; *f; f++) {
		if (isspace((unsigned char)*f)) {
			while (isspace((unsigned char)*s)) {
				s++;
			}
			continue;
		}
		if (*f != '%') {
			if (*s == *f) {
				s++;
				continue;
			}
			break;
		}

		f++;
		int width = 0;

		while (isdigit((unsigned char)*f)) {
			width = width * 10 + (*f - '0');
			f++;
		}
		while (*f == 'l' || *f == 'h' || *f == 'z') {
			f++;
		}
		char conv = *f;
		char *end;

		if (conv == 'c') {
			char *out = va_arg(ap, char *);

			if (!*s) {
				break;
			}
			*out = *s++;
			count++;
			continue;
		}

		while (isspace((unsigned char)*s)) {
			s++;
		}

		if (conv == 'd' || conv == 'i' || conv == 'u' ||
		    conv == 'x' || conv == 'X' || conv == 'o') {
			int base = (conv == 'x' || conv == 'X') ? 16 :
				   (conv == 'o') ? 8 :
				   (conv == 'i') ? 0 : 10;
			long v = strtol(s, &end, base);

			if (end == s) {
				break;
			}
			*va_arg(ap, int *) = (int)v;
			s = end;
			count++;
		} else if (conv == 'f' || conv == 'g' || conv == 'e') {
			double v = strtod(s, &end);

			if (end == s) {
				break;
			}
			*va_arg(ap, float *) = (float)v;
			s = end;
			count++;
		} else if (conv == 's') {
			char *out = va_arg(ap, char *);
			int n = 0;

			while (*s && !isspace((unsigned char)*s) &&
			       (width == 0 || n < width)) {
				*out++ = *s++;
				n++;
			}
			*out = '\0';
			if (n == 0) {
				break;
			}
			count++;
		} else if (conv == '%') {
			if (*s == '%') {
				s++;
			} else {
				break;
			}
		} else {
			break;
		}
	}
	va_end(ap);
	return count;
}
```

## src/doomgeneric_zephyr.c
```c
/*
 * doomgeneric_zephyr.c — KlaussCPU/Zephyr platform backend for doomgeneric.
 *
 * Implements the six DG_* hooks doomgeneric needs and provides the Zephyr app
 * main(): mount the SD card (for the WAD), get an IP (DHCP), start the VNC
 * server (the display), then run the Doom game loop on a dedicated thread.
 *
 * Doom renders into DG_ScreenBuffer (640x400, XRGB8888); DG_DrawFrame converts
 * that to the VNC module's RGB565 framebuffer, centred vertically in 640x480.
 * Keyboard input is wired: the VNC server delivers RFB KeyEvents (X11 keysyms)
 * to on_key(), which maps them to Doom key codes and queues them for DG_GetKey()
 * — so the game is playable over VNC, not just attract-mode demos.
 */

#include <zephyr/kernel.h>
#include <zephyr/logging/log.h>
#include <zephyr/storage/disk_access.h>
#include <zephyr/fs/fs.h>
#include <ff.h>
#ifdef CONFIG_NETWORKING
#include <zephyr/net/net_if.h>
#include <zephyr/net/net_mgmt.h>
#include <zephyr/net/net_ip.h>
#include <zephyr/net/dhcpv4.h>
#endif

#include "framebuffer.h"
#ifdef CONFIG_KLAUSSCPU_VNC_SERVER
#include "vnc_server.h"
#endif
#ifdef CONFIG_KLAUSSCPU_VGA
#include "vga_out.h"         /* KlaussCPU VGA port: 8-bit frames + palette */
#endif
#include "doomgeneric.h"
#include "doomkeys.h"
#ifdef CMAP256
#include "i_video.h"         /* colors[], palette_changed */
#endif

LOG_MODULE_REGISTER(doom, LOG_LEVEL_INF);

/* Centre Doom's image in the framebuffer (640x480).  At 320x200 it sits in the
 * middle; the VNC client scales it up for display. */
#define FB_XOFF  ((FB_WIDTH  - DOOMGENERIC_RESX) / 2)
#define FB_YOFF  ((FB_HEIGHT - DOOMGENERIC_RESY) / 2)

BUILD_ASSERT(DOOMGENERIC_RESX <= FB_WIDTH, "Doom width must fit framebuffer");
BUILD_ASSERT(DOOMGENERIC_RESY <= FB_HEIGHT, "Doom height must fit framebuffer");

#ifdef CONFIG_DOOM_PROFILE
/* Wall-clock ms timing (ms resolution is enough; k_cycle_get_32/64 now read
 * the free-running PERF_CYCLES counter and work too).  tick =
 * whole doomgeneric_Tick (includes any preemption by the VNC send thread);
 * convert = the ARGB->RGB565 loop; draws counts actual DG_DrawFrame calls so we
 * can see how many ticks actually paint. */
#define PROF_WINDOW   20
static uint64_t prof_tick_ms;
static uint64_t prof_conv_ms;
static uint32_t prof_ticks;
static uint32_t prof_draws;
static int64_t  prof_t0_ms;
#endif

/* ── DG platform hooks ──────────────────────────────────────────────────── */

void DG_Init(void)
{
}

#ifdef CMAP256
/* Doom's current palette as RGB565, rebuilt when the engine changes palette
 * (damage/pickup flashes, menus) — see CMAP256 in CMakeLists.txt. */
static uint16_t pal565[256];
#endif

void DG_DrawFrame(void)
{
	fb_lock();
	uint16_t *dst = fb_pixels();
#ifdef CONFIG_DOOM_PROFILE
	int64_t c0 = k_uptime_get();
#endif

#ifdef CMAP256
	const uint8_t *src = (const uint8_t *)DG_ScreenBuffer;
	/* The RGB565 framebuffer only feeds VNC.  VGA takes Doom's 8-bit frame
	 * directly (zero-copy, below), so a VGA-only build skips the
	 * per-pixel conversion entirely. */
#ifdef CONFIG_KLAUSSCPU_VNC_SERVER
	bool convert = true;
#else
	bool convert = false;
#endif
#ifdef CONFIG_KLAUSSCPU_VGA
	uint32_t rgb[256];
	bool rgb_new = false;
#endif

	if (palette_changed) {
		for (int i = 0; i < 256; i++) {
			pal565[i] = fb_rgb(colors[i].r, colors[i].g, colors[i].b);
#ifdef CONFIG_KLAUSSCPU_VGA
			rgb[i] = ((uint32_t)colors[i].r << 16) | ((uint32_t)colors[i].g << 8) | colors[i].b;
#endif
		}
#ifdef CONFIG_KLAUSSCPU_VGA
		rgb_new = true;
#endif
		palette_changed = false;
	}
	for (int y = 0; convert && y < DOOMGENERIC_RESY; y++) {
		uint16_t *drow = dst + (size_t)(y + FB_YOFF) * FB_WIDTH + FB_XOFF;
		const uint8_t *srow = src + (size_t)y * DOOMGENERIC_RESX;
		int x = 0;

		/* 8 pixels per step: one u64 load of indices, two u64 stores
		 * (little-endian: pixel 0 in the low 16 bits). */
		if ((((uintptr_t)drow | (uintptr_t)srow) & 7u) == 0) {
			const uint64_t *s64 = (const uint64_t *)(const void *)srow;
			uint64_t *d64 = (uint64_t *)(void *)drow;

			for (; x + 8 <= DOOMGENERIC_RESX; x += 8) {
				uint64_t i = *s64++;

				*d64++ = (uint64_t)pal565[i & 0xFF] |
					 ((uint64_t)pal565[(i >> 8) & 0xFF] << 16) |
					 ((uint64_t)pal565[(i >> 16) & 0xFF] << 32) |
					 ((uint64_t)pal565[(i >> 24) & 0xFF] << 48);
				*d64++ = (uint64_t)pal565[(i >> 32) & 0xFF] |
					 ((uint64_t)pal565[(i >> 40) & 0xFF] << 16) |
					 ((uint64_t)pal565[(i >> 48) & 0xFF] << 32) |
					 ((uint64_t)pal565[i >> 56] << 48);
			}
		}
		for (; x < DOOMGENERIC_RESX; x++) {
			drow[x] = pal565[srow[x]];
		}
	}
#ifdef CONFIG_KLAUSSCPU_VGA
	{
		const uint32_t *pal = rgb_new ? rgb : NULL;
		/* Zero-copy: I_FinishUpdate rewrites the whole of DG_ScreenBuffer
		 * every frame, so point it at a free VGA buffer and present that
		 * buffer as-is (triple-buffered: never one on screen).  The first
		 * frame is still in doomgeneric's own buffer — copy it once. */
		if (vga_out_present_indexed((uint8_t *)src, pal) != 0) {
			vga_out_show_indexed(src, DOOMGENERIC_RESX, DOOMGENERIC_RESY, pal);
		}
		uint8_t *next = vga_out_indexed_buffer(DOOMGENERIC_RESX, DOOMGENERIC_RESY);

		if (next != NULL) {
			DG_ScreenBuffer = (pixel_t *)next;
		}
	}
#endif
#else
	const uint32_t *src = (const uint32_t *)DG_ScreenBuffer;

	for (int y = 0; y < DOOMGENERIC_RESY; y++) {
		uint16_t *drow = dst + (size_t)(y + FB_YOFF) * FB_WIDTH + FB_XOFF;
		const uint32_t *srow = src + (size_t)y * DOOMGENERIC_RESX;

		for (int x = 0; x < DOOMGENERIC_RESX; x++) {
			uint32_t p = srow[x];   /* 0x00RRGGBB */

			drow[x] = fb_rgb((p >> 16) & 0xFF, (p >> 8) & 0xFF, p & 0xFF);
		}
	}
#endif
#ifdef CONFIG_DOOM_PROFILE
	prof_conv_ms += k_uptime_get() - c0;
	prof_draws++;
#endif
	fb_unlock();

	fb_mark_dirty(FB_XOFF, FB_YOFF, DOOMGENERIC_RESX, DOOMGENERIC_RESY);
}

void DG_SleepMs(uint32_t ms)
{
	k_msleep((int32_t)ms);
}

uint32_t DG_GetTicksMs(void)
{
	return (uint32_t)k_uptime_get();
}

/* ── VNC keyboard input → Doom ───────────────────────────────────────────────
 * The VNC server calls on_key() from its connection thread for every RFB
 * KeyEvent (an X11 keysym + press/release).  We map the keysym to a Doom key
 * code and push (pressed<<8 | key) into a small ring that the Doom thread drains
 * in DG_GetKey().  This mirrors doomgeneric's own X11 backend
 * (doomgeneric_xlib.c), which feeds the same shared i_input.c, so the key
 * handling is identical to a normal Doom build.
 *
 * The ring is single-producer (VNC thread) / single-consumer (Doom thread).
 * Both indices are volatile and word-sized, and the queue slot is written before
 * its index is advanced — volatile guarantees that ordering — so no lock is
 * needed on this single core (same approach as the LVGL app's volatile input
 * globals). */
#define KEYQUEUE_SIZE 16
static volatile unsigned short key_queue[KEYQUEUE_SIZE];
static volatile unsigned int   key_wr;   /* advanced by the VNC thread  */
static volatile unsigned int   key_rd;   /* advanced by the Doom thread */

#ifdef CONFIG_KLAUSSCPU_VNC_SERVER
/* X11 keysyms — Zephyr's minimal libc has no <X11/keysymdef.h>. */
#define XK_BackSpace  0xff08u
#define XK_Return     0xff0du
#define XK_Escape     0xff1bu
#define XK_Left       0xff51u
#define XK_Up         0xff52u
#define XK_Right      0xff53u
#define XK_Down       0xff54u
#define XK_Shift_L    0xffe1u
#define XK_Shift_R    0xffe2u
#define XK_Control_L  0xffe3u
#define XK_Control_R  0xffe4u
#define XK_space      0x0020u

/* keysym → Doom key code (doomkeys.h).  Same mapping as doomgeneric_xlib.c,
 * except unmapped keysyms >= 0x80 return 0 (ignored) rather than being passed
 * through tolower(): the Doom control codes live at 0xa0-0xaf, so a raw high
 * keysym could otherwise alias KEY_FIRE/arrows and inject phantom input. */
static unsigned char keysym_to_doom(uint32_t k)
{
	switch (k) {
	case XK_Return:    return KEY_ENTER;
	case XK_Escape:    return KEY_ESCAPE;
	case XK_Left:      return KEY_LEFTARROW;
	case XK_Right:     return KEY_RIGHTARROW;
	case XK_Up:        return KEY_UPARROW;
	case XK_Down:      return KEY_DOWNARROW;
	case XK_Control_L:
	case XK_Control_R: return KEY_FIRE;      /* Ctrl  = fire        */
	case XK_space:     return KEY_USE;       /* Space = use / open  */
	case XK_Shift_L:
	case XK_Shift_R:   return KEY_RSHIFT;    /* Shift = run         */
	case XK_BackSpace: return KEY_BACKSPACE;
	default:
		if (k >= 'A' && k <= 'Z') {
			return (unsigned char)(k + 32);  /* tolower: menu y/n etc. */
		}
		if (k < 0x80u) {
			return (unsigned char)k;         /* printable ASCII incl. 1-7 */
		}
		return 0;                                /* unmapped keysym → ignore */
	}
}

/* RFB KeyEvent handler — runs on the VNC connection thread; keep it short. */
static void on_key(bool pressed, uint32_t keysym)
{
	unsigned char k = keysym_to_doom(keysym);

	if (k == 0) {
		return;   /* a key Doom doesn't use */
	}

	unsigned int wr = key_wr;

	key_queue[wr] = (unsigned short)(((unsigned int)pressed << 8) | k);
	key_wr = (wr + 1u) % KEYQUEUE_SIZE;
}
#endif /* CONFIG_KLAUSSCPU_VNC_SERVER */

int DG_GetKey(int *pressed, unsigned char *key)
{
	if (key_rd == key_wr) {
		return 0;   /* queue empty */
	}

	unsigned short kd = key_queue[key_rd];

	key_rd = (key_rd + 1u) % KEYQUEUE_SIZE;
	*pressed = kd >> 8;
	*key = (unsigned char)(kd & 0xFFu);
	return 1;
}

void DG_SetWindowTitle(const char *title)
{
	ARG_UNUSED(title);
}

/* ── SD mount + DHCP (mirrors ssh_shell) ────────────────────────────────── */

static FATFS fat_fs;
static struct fs_mount_t fatfs_mnt = {
	.type = FS_FATFS,
	.fs_data = &fat_fs,
	.mnt_point = "/SD:",
};

static int mount_sd(void)
{
	int rc = disk_access_init("SD");

	if (rc != 0) {
		LOG_ERR("SD init failed: %d", rc);
		return rc;
	}
	rc = fs_mount(&fatfs_mnt);
	if (rc != 0) {
		LOG_ERR("FatFS mount failed: %d", rc);
		return rc;
	}
	LOG_INF("SD card mounted at /SD:/");
	return 0;
}

#ifdef CONFIG_NETWORKING
static struct net_mgmt_event_callback dhcp_cb;
static struct k_sem dhcp_sem;

static void dhcp_handler(struct net_mgmt_event_callback *cb,
			 uint64_t mgmt_event, struct net_if *iface)
{
	ARG_UNUSED(cb);
	ARG_UNUSED(iface);
	if (mgmt_event == NET_EVENT_IPV4_DHCP_BOUND) {
		k_sem_give(&dhcp_sem);
	}
}

static int wait_for_dhcp(void)
{
	k_sem_init(&dhcp_sem, 0, 1);
	net_mgmt_init_event_callback(&dhcp_cb, dhcp_handler,
				     NET_EVENT_IPV4_DHCP_BOUND);
	net_mgmt_add_event_callback(&dhcp_cb);

	struct net_if *iface = net_if_get_default();

	if (!iface) {
		LOG_ERR("No network interface");
		return -1;
	}
	net_dhcpv4_start(iface);
	if (k_sem_take(&dhcp_sem, K_SECONDS(10)) != 0) {
		LOG_WRN("DHCP timeout");
		return -1;
	}
	return 0;
}

#endif /* CONFIG_NETWORKING */

/* ── Doom game-loop thread ──────────────────────────────────────────────── */

#define DOOM_STACK_SIZE 131072
/* Lower priority than the VNC server (7) and net threads: Doom's tick loop
 * never blocks when it can't keep up 35 fps, so at equal priority it starves
 * the I/O threads (VNC connect hangs, no frames sent).  Run it in the
 * background so networking always preempts it. */
#define DOOM_PRIO       12
static K_THREAD_STACK_DEFINE(doom_stack, DOOM_STACK_SIZE);
static struct k_thread doom_thread;

static void doom_entry(void *a, void *b, void *c)
{
	ARG_UNUSED(a);
	ARG_UNUSED(b);
	ARG_UNUSED(c);

	char *argv[] = { "doom", "-iwad", "/SD:/doom1.wad" };

	doomgeneric_Create(ARRAY_SIZE(argv), argv);

#ifdef CONFIG_DOOM_PROFILE
	prof_t0_ms = k_uptime_get();
#endif

	for (;;) {
#ifdef CONFIG_DOOM_PROFILE
		int64_t t0 = k_uptime_get();
#endif
		doomgeneric_Tick();
#ifdef CONFIG_DOOM_PROFILE
		prof_tick_ms += k_uptime_get() - t0;

		if (++prof_ticks >= PROF_WINDOW) {
			int64_t now = k_uptime_get();
			uint32_t wall = (uint32_t)(now - prof_t0_ms);

			printk("doom: drawfps=%u tick=%ums convert=%ums "
			       "(draws=%u/%u ticks in %ums)"
#ifdef CONFIG_KLAUSSCPU_VGA
			       " vga_underflows=%u"
#endif
			       "\n",
			       wall ? (prof_draws * 1000U / wall) : 0U,
			       (uint32_t)(prof_tick_ms / prof_ticks),
			       prof_draws ? (uint32_t)(prof_conv_ms / prof_draws) : 0U,
			       prof_draws, prof_ticks, wall
#ifdef CONFIG_KLAUSSCPU_VGA
			       , vga_out_underflows()
#endif
			       );

			prof_tick_ms = 0;
			prof_conv_ms = 0;
			prof_ticks = 0;
			prof_draws = 0;
			prof_t0_ms = now;
		}
#endif
	}
}

/* Route libc stdout (Doom's printf/puts/putchar) to printk → UART.  The board
 * has no generic console driver (CONSOLE_HAS_DRIVER=n), so CONFIG_STDOUT_CONSOLE
 * can't be used; install the minimal-libc hook directly instead. */
extern void __stdout_hook_install(int (*hook)(int));
static int doom_stdout(int c)
{
	printk("%c", (char)c);
	return c;
}

int main(void)
{
	__stdout_hook_install(doom_stdout);
	printk("\nKlaussCPU DOOM\n");

	if (mount_sd() != 0) {
		LOG_ERR("no SD card — cannot load WAD");
	}
#ifdef CONFIG_KLAUSSCPU_VNC_SERVER
	if (wait_for_dhcp() != 0) {
		LOG_WRN("no network — VNC will be unreachable");
	}

	vnc_server_start();
	vnc_register_input(on_key, NULL);   /* keyboard -> Doom; no pointer */
	LOG_INF("VNC server ready on port 5900 — connect to play");
#else
	LOG_INF("VGA only (no VNC): no keyboard input — attract-mode demos");
#endif

	k_thread_create(&doom_thread, doom_stack, DOOM_STACK_SIZE,
			doom_entry, NULL, NULL, NULL, DOOM_PRIO, 0, K_NO_WAIT);
	k_thread_name_set(&doom_thread, "doom");

	/* Do NOT return from main on this arch: the KlaussCPU thread-exit path
	 * jumps to a null return address (PC=0 crash).  Idle here forever, like
	 * the ssh_shell app — the Doom thread does the work. */
	k_sleep(K_FOREVER);
	return 0;
}
```

## src/zephyr_stdio.c
```c
/*
 * zephyr_stdio.c — fs_*-backed implementations of the stdio file functions
 * Doom needs (fopen/fread/fseek/ftell/fclose/feof), since Zephyr's minimal libc
 * provides only console output (fwrite/fputs/fprintf to stdout/stderr).
 *
 * FILE is `typedef int FILE` in minimal libc, so a FILE* is just an opaque
 * handle.  We return a pointer into file_ids[] (distinct from the (FILE*)1/2/3
 * used for stdin/stdout/stderr); the pointed-to int is the slot index.
 *
 * Doom's WAD reading goes fopen->fread/fseek through here onto /SD:.  POSIX
 * directory/stat calls used only by the IWAD *search* are stubbed to fail —
 * we pass an explicit -iwad path, so the search isn't exercised.
 */

#include <zephyr/kernel.h>
#include <zephyr/fs/fs.h>
#include <string.h>
#include <stdlib.h>
#include <ctype.h>

#include "zephyr_stdio.h"

#define MAX_FILES 8

static struct {
	struct fs_file_t f;
	bool used;
	bool eof;
} files[MAX_FILES];

/* Returned to callers as FILE*; the value at each slot is its own index. */
static int  file_ids[MAX_FILES];
static bool ids_init;
static K_MUTEX_DEFINE(files_mutex);

static int slot_of(FILE *fp)
{
	int *p = (int *)fp;

	if (p < &file_ids[0] || p > &file_ids[MAX_FILES - 1]) {
		return -1;   /* not one of ours (e.g. stdin/stdout/stderr) */
	}
	return (int)(p - file_ids);
}

FILE *fopen(const char *path, const char *mode)
{
	bool want_read = false, want_write = false, append = false;

	for (const char *m = mode; *m; m++) {
		if (*m == 'r') {
			want_read = true;
		} else if (*m == 'w') {
			want_write = true;
		} else if (*m == 'a') {
			want_write = true;
			append = true;
		} else if (*m == '+') {
			want_read = true;
			want_write = true;
		}
	}

	fs_mode_t flags;

	if (want_write && want_read) {
		flags = FS_O_RDWR | FS_O_CREATE;
	} else if (want_write) {
		flags = FS_O_WRITE | FS_O_CREATE;
	} else {
		flags = FS_O_READ;
	}
	if (append) {
		flags |= FS_O_APPEND;
	}

	k_mutex_lock(&files_mutex, K_FOREVER);

	if (!ids_init) {
		for (int i = 0; i < MAX_FILES; i++) {
			file_ids[i] = i;
		}
		ids_init = true;
	}

	int slot = -1;

	for (int i = 0; i < MAX_FILES; i++) {
		if (!files[i].used) {
			slot = i;
			break;
		}
	}
	if (slot < 0) {
		k_mutex_unlock(&files_mutex);
		return NULL;
	}

	fs_file_t_init(&files[slot].f);
	if (fs_open(&files[slot].f, path, flags) < 0) {
		k_mutex_unlock(&files_mutex);
		return NULL;
	}
	if (want_write && !append) {
		(void)fs_truncate(&files[slot].f, 0);
	}
	files[slot].used = true;
	files[slot].eof = false;

	k_mutex_unlock(&files_mutex);
	return (FILE *)&file_ids[slot];
}

int fclose(FILE *fp)
{
	int slot = slot_of(fp);

	if (slot < 0 || !files[slot].used) {
		return EOF;
	}
	fs_close(&files[slot].f);
	files[slot].used = false;
	return 0;
}

size_t fread(void *ptr, size_t size, size_t nmemb, FILE *fp)
{
	int slot = slot_of(fp);

	if (slot < 0 || size == 0) {
		return 0;
	}

	size_t total = size * nmemb;
	ssize_t r = fs_read(&files[slot].f, ptr, total);

	if (r <= 0) {
		files[slot].eof = true;
		return 0;
	}
	if ((size_t)r < total) {
		files[slot].eof = true;
	}
	return (size_t)r / size;
}

int fseek(FILE *fp, long offset, int whence)
{
	int slot = slot_of(fp);

	if (slot < 0) {
		return -1;
	}

	int w = (whence == SEEK_CUR) ? FS_SEEK_CUR :
		(whence == SEEK_END) ? FS_SEEK_END : FS_SEEK_SET;

	files[slot].eof = false;
	return (fs_seek(&files[slot].f, offset, w) < 0) ? -1 : 0;
}

long ftell(FILE *fp)
{
	int slot = slot_of(fp);

	if (slot < 0) {
		return -1;
	}
	return (long)fs_tell(&files[slot].f);
}

int feof(FILE *fp)
{
	int slot = slot_of(fp);

	return (slot < 0) ? 1 : files[slot].eof;
}

int fflush(FILE *fp)
{
	ARG_UNUSED(fp);
	return 0;
}

int fileno(FILE *fp)
{
	/* stdin/stdout/stderr are (FILE*)1/2/3 in minimal libc -> fds 0/1/2. */
	if (fp == stdin)  { return 0; }
	if (fp == stdout) { return 1; }
	if (fp == stderr) { return 2; }
	int slot = slot_of(fp);

	return (slot < 0) ? -1 : slot + 3;
}

/* ── POSIX fd I/O on the same file table (fd == slot + 3) ────────────────── */

/* Local copies of the compat <fcntl.h> flag values (this TU uses Zephyr
 * headers, not the compat ones). */
#define DG_O_WRONLY 1
#define DG_O_RDWR   2
#define DG_O_CREAT  0x40
#define DG_O_TRUNC  0x200
#define DG_O_APPEND 0x400

int open(const char *path, int flags, ...)
{
	int acc = flags & 3;
	fs_mode_t f;

	if (acc == DG_O_WRONLY) {
		f = FS_O_WRITE | FS_O_CREATE;
	} else if (acc == DG_O_RDWR) {
		f = FS_O_RDWR | FS_O_CREATE;
	} else {
		f = FS_O_READ;
	}
	if (flags & DG_O_APPEND) {
		f |= FS_O_APPEND;
	}
	(void)DG_O_CREAT;

	k_mutex_lock(&files_mutex, K_FOREVER);
	if (!ids_init) {
		for (int i = 0; i < MAX_FILES; i++) {
			file_ids[i] = i;
		}
		ids_init = true;
	}
	int slot = -1;

	for (int i = 0; i < MAX_FILES; i++) {
		if (!files[i].used) {
			slot = i;
			break;
		}
	}
	if (slot < 0) {
		k_mutex_unlock(&files_mutex);
		return -1;
	}
	fs_file_t_init(&files[slot].f);
	if (fs_open(&files[slot].f, path, f) < 0) {
		k_mutex_unlock(&files_mutex);
		return -1;
	}
	if ((flags & DG_O_TRUNC) && acc != 0) {
		(void)fs_truncate(&files[slot].f, 0);
	}
	files[slot].used = true;
	files[slot].eof = false;
	k_mutex_unlock(&files_mutex);
	return slot + 3;
}

static int fd_slot(int fd)
{
	int slot = fd - 3;

	if (slot < 0 || slot >= MAX_FILES || !files[slot].used) {
		return -1;
	}
	return slot;
}

int close(int fd)
{
	int slot = fd_slot(fd);

	if (slot < 0) {
		return -1;
	}
	fs_close(&files[slot].f);
	files[slot].used = false;
	return 0;
}

ssize_t read(int fd, void *buf, size_t n)
{
	int slot = fd_slot(fd);

	return (slot < 0) ? -1 : fs_read(&files[slot].f, buf, n);
}

ssize_t write(int fd, const void *buf, size_t n)
{
	int slot = fd_slot(fd);

	return (slot < 0) ? -1 : fs_write(&files[slot].f, buf, n);
}

off_t lseek(int fd, off_t off, int whence)
{
	int slot = fd_slot(fd);

	if (slot < 0) {
		return -1;
	}

	int w = (whence == SEEK_CUR) ? FS_SEEK_CUR :
		(whence == SEEK_END) ? FS_SEEK_END : FS_SEEK_SET;

	if (fs_seek(&files[slot].f, off, w) < 0) {
		return -1;
	}
	return (off_t)fs_tell(&files[slot].f);
}

/* ── string/file helpers minimal libc lacks ─────────────────────────────── */

/* strcasecmp() comes from minimal libc (zephyr-patches/minimal-libc-strcasecmp.patch). */

char *strdup(const char *s)
{
	size_t n = strlen(s) + 1;
	char *p = malloc(n);

	if (p) {
		memcpy(p, s, n);
	}
	return p;
}

/* remove() comes from Zephyr's common libc (CONFIG_COMMON_LIBC_REMOVE). */

int rename(const char *from, const char *to)
{
	return (fs_rename(from, to) < 0) ? -1 : 0;
}
```

## src/zephyr_stdio.h
```c
/*
 * zephyr_stdio.h — declarations for the stdio file functions that Zephyr's
 * minimal libc lacks, so Doom's <stdio.h> users see correct prototypes (else
 * implicit declarations would truncate the returned FILE* on this LP64 target).
 *
 * Force-included into the Doom engine sources (see CMakeLists.txt).
 * Implementations are in zephyr_stdio.c, backed by Zephyr's fs_* API.
 */

#ifndef KLAUSSCPU_DOOM_ZEPHYR_STDIO_H_
#define KLAUSSCPU_DOOM_ZEPHYR_STDIO_H_

#include <stddef.h>
#include <stdio.h>      /* FILE (== int in minimal libc), EOF */

#ifndef SEEK_SET
#define SEEK_SET 0
#define SEEK_CUR 1
#define SEEK_END 2
#endif

#ifdef __cplusplus
extern "C" {
#endif

FILE  *fopen(const char *path, const char *mode);
int    fclose(FILE *fp);
size_t fread(void *ptr, size_t size, size_t nmemb, FILE *fp);
int    fseek(FILE *fp, long offset, int whence);
long   ftell(FILE *fp);
int    feof(FILE *fp);
int    fflush(FILE *fp);
int    fileno(FILE *fp);

/* Also missing from minimal libc (must be declared so pointer returns aren't
 * truncated under implicit declaration). */
int    strcasecmp(const char *a, const char *b);
char  *strdup(const char *s);
int    remove(const char *path);
int    rename(const char *from, const char *to);
int    sscanf(const char *str, const char *fmt, ...);
double strtod(const char *s, char **end);
double atof(const char *s);
int    system(const char *cmd);

/* libm subset Doom uses at renderer init (no libm in this build). */
double fabs(double x);
double sin(double x);
double cos(double x);
double tan(double x);
double atan(double x);

#ifdef __cplusplus
}
#endif

#endif /* KLAUSSCPU_DOOM_ZEPHYR_STDIO_H_ */
```
