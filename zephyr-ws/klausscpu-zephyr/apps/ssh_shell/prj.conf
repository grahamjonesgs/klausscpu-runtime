## CMakeLists.txt
```
cmake_minimum_required(VERSION 3.20)
find_package(Zephyr REQUIRED HINTS $ENV{ZEPHYR_BASE})
project(klausscpu_ssh_shell)

target_sources(app PRIVATE src/main.c)

# Loadable API backend extension (the /api/* route logic).
#
# httpd + httpsd stay in the kernel; only the backend handler is loadable —
# apibackend.c registers it via webapi_register() at svc_start (see webapi.c).
# It is a single-source ELF-object llext (CONFIG_LLEXT_TYPE_ELF_OBJECT allows
# only one source per llext), compiled against THIS app's Zephyr config so its
# ABI matches the kernel that loads it.  The .llext is emitted to the build dir;
# copy it to the SD card (/SD:/apibackend.llext) and load it with `svc load`.
if(CONFIG_LLEXT)
  get_filename_component(apibackend_src
    ${CMAKE_CURRENT_SOURCE_DIR}/../../ssh/apibackend.c ABSOLUTE)
  # Override two inherited Zephyr flags for the extension (LLEXT_APPEND_FLAGS is
  # appended after them by add_llext_target, so these win; the toolchain's
  # long-calls flag, cmake/compiler/clang/target.cmake, stays):
  #   -fno-data-sections : the default -fdata-sections puts every global in its
  #       own .bss.<name>, but the loader allows only one SHT_NOBITS section
  #       ("Multiple SHT_NOBITS sections are not supported") — coalesce to one .bss.
  #   -g0                : the default -g -gdwarf-4 emits .debug_* sections WITH
  #       .rela.debug_* relocation sections; the loader then tries to relocate a
  #       non-allocated debug section and fails ("Section N not loaded in any
  #       memory region").  Dropping debug info removes those rela sections.
  list(APPEND LLEXT_APPEND_FLAGS -fno-data-sections -g0)
  add_llext_target(apibackend
    OUTPUT  ${CMAKE_BINARY_DIR}/apibackend.llext
    SOURCES ${apibackend_src}
  )
  add_dependencies(app apibackend)

  # Example second backend (claims "/ctrl/") to demonstrate prefix-keyed
  # dispatch — load it alongside apibackend.llext. Same flags apply.
  get_filename_component(ctrlbackend_src
    ${CMAKE_CURRENT_SOURCE_DIR}/../../ssh/ctrlbackend.c ABSOLUTE)
  add_llext_target(ctrlbackend
    OUTPUT  ${CMAKE_BINARY_DIR}/ctrl.llext
    SOURCES ${ctrlbackend_src}
  )
  add_dependencies(app ctrlbackend)
endif()
```

## prj.conf
```kconfig
# ── Core ──────────────────────────────────────────────────────────────────
CONFIG_XIP=n
CONFIG_CBPRINTF_FP_SUPPORT=n
CONFIG_CBPRINTF_FP_A_SUPPORT=n

# ── UART ──────────────────────────────────────────────────────────────────
CONFIG_UART_KLAUSSCPU=y
CONFIG_UART_CONSOLE=y

# ── Timer ─────────────────────────────────────────────────────────────────
CONFIG_KLAUSSCPU_TIMER=y
CONFIG_SYS_CLOCK_HW_CYCLES_PER_SEC=100000000
# 1 kHz tick (was 100 Hz = 10 ms).  The eth RX driver polls with
# k_sleep(K_MSEC(1)), which rounds up to one tick — at 100 Hz that's a 10 ms
# poll, long enough for the 2-slot RX ring to overflow under broadcast load and
# drop single reply packets (ping/NTP replies).  1 kHz -> ~1 ms RX poll.
CONFIG_SYS_CLOCK_TICKS_PER_SEC=1000

# ── Networking ────────────────────────────────────────────────────────────
CONFIG_NETWORKING=y
CONFIG_NET_L2_ETHERNET=y
CONFIG_ETH_KLAUSSCPU=y
CONFIG_NET_IPV4=y
CONFIG_NET_IPV6=n
CONFIG_NET_DHCPV4=y
CONFIG_NET_SOCKETS=y
CONFIG_NET_TCP=y
CONFIG_NET_UDP=y
# SNTP (network time) + DNS so file timestamps are real (no RTC on the board).
CONFIG_DNS_RESOLVER=y
CONFIG_SNTP=y
# Network diagnostics shell: `net iface` / `net ping <ip>` / `net dns <host>` /
# `net route` / `net stats`.  NET_SHELL selects REQUIRES_FLOAT_PRINTF (ping RTT
# uses %f), so enable FP printf (soft-FP is available via compiler-rt).
CONFIG_NET_SHELL=y
CONFIG_CBPRINTF_FP_SUPPORT=y
CONFIG_NET_STATISTICS=y
# KlaussCPU's 64-bit pointers/longs make every stack frame larger than on a
# 32-bit target, so several stock net thread stacks overflow during packet
# processing and silently corrupt neighbouring memory (this manifested as a
# mangled node in a socket recv-queue poll list -> DNS/SNTP responses never
# dispatched).  The net RX traffic-class thread (rx_q[0], CONFIG_NET_RX_STACK_SIZE)
# overflowed handling an inbound packet.  Give the net + socket-service threads
# real headroom, and keep STACK_SENTINEL on to panic-name any future overflow.
CONFIG_NET_RX_STACK_SIZE=8192
CONFIG_NET_TX_STACK_SIZE=8192
CONFIG_NET_SOCKETS_SERVICE_STACK_SIZE=8192
CONFIG_NET_MGMT_EVENT_STACK_SIZE=8192
# tcp_work queue: overflowed during the wolfSSH handshake's TCP churn (the TCP
# state machine + net_pkt processing on 64-bit frames).  Default (~1200) is far
# too small here; size it with the rest.  HTTP + SFTP add more TCP load too.
CONFIG_NET_TCP_WORKQ_STACK_SIZE=8192
CONFIG_STACK_SENTINEL=y

# Network buffers.  lwIP works on this same board with a 2-slot ring, so the RX
# bottleneck is here, not the HW: the stock pools were ~5 full frames
# (BUF_RX_COUNT=32 x 256B; a 1500B frame needs 6 bufs), which the /22 broadcast
# burst exhausts -> net_pkt alloc fails -> frames (incl. replies) discarded.
# One 1536B buffer per frame + generous counts (RAM is plentiful).
# Zephyr sizes each TCP window from these pools (count x 1536 / 3, capped at
# 64 KiB).  At 48 TX buffers the send window was 24 KiB, less than one 32 KiB
# SFTP reply, so every reply waited for ACKs mid-way; 160/192 give both
# windows the full 64 KiB.
CONFIG_NET_PKT_RX_COUNT=128
CONFIG_NET_PKT_TX_COUNT=96
CONFIG_NET_BUF_RX_COUNT=192
CONFIG_NET_BUF_TX_COUNT=160
CONFIG_NET_BUF_DATA_SIZE=1536

# Logging — deferred mode: a dedicated log thread drains a buffer to the
# backends, instead of each LOG_* call formatting/writing synchronously on the
# calling thread.  This is required now that logs are also persisted to the SD
# card (CONFIG_LOG_BACKEND_FS below): immediate-mode SD writes would block the
# net/server/SSH threads on every log line.  Trade-off: UART boot messages are
# slightly less real-time than before, and under a heavy burst the deferred
# buffer can drop (rather than block) — size LOG_BUFFER_SIZE accordingly.
# (Log output does NOT reach the shell/SSH sessions — CONFIG_SHELL_LOG_BACKEND=n;
# it goes to the UART and the SD file backends only.)
CONFIG_LOG_MODE_DEFERRED=y
CONFIG_LOG_BUFFER_SIZE=4096
CONFIG_NET_LOG=y

# Persist logs to the SD card so they can be inspected after the fact (download
# over SFTP/HTTP or `cat /SD:/log/klaus_0000`).  Additive with the UART backend.
# The backend creates /SD:/log itself (fs_mkdir) and names files PREFIX + a
# 4-digit index with no extension: /SD:/log/klaus_0000, klaus_0001, ...  It can
# only write once /SD: is mounted (see mount_sd() in main.c); earlier lines reach
# the UART only.  Files rotate at FILE_SIZE, keeping FILES_LIMIT of them.
CONFIG_LOG_BACKEND_FS=y
CONFIG_LOG_BACKEND_FS_DIR="/SD:/log"
CONFIG_LOG_BACKEND_FS_FILE_PREFIX="klaus_"
CONFIG_LOG_BACKEND_FS_FILE_SIZE=65536
CONFIG_LOG_BACKEND_FS_FILES_LIMIT=4

# ── QSPI flash keystore ──────────────────────────────────────────────────
# Private keys (SSH host key, TLS key + cert) live in NVS on the board's QSPI
# configuration flash (storage_partition, 0xF0_0000, above the bitstream) so
# they survive SD card swaps.  ssh/keystore.c; falls back to /SD:/sys on a
# bitstream without klaussCPU's qspi_ctrl (the flash device is then not ready).
CONFIG_FLASH=y
CONFIG_FLASH_PAGE_LAYOUT=y
CONFIG_FLASH_MAP=y
CONFIG_NVS=y
# CRC over each stored value, not just the entry headers (on-flash format:
# keep it on, or existing entries read as missing).
CONFIG_NVS_DATA_CRC=y

# ── SD card + filesystem ─────────────────────────────────────────────────
CONFIG_DISK_ACCESS=y
CONFIG_DISK_KLAUSSCPU_SD=y
CONFIG_FILE_SYSTEM=y
CONFIG_FAT_FILESYSTEM_ELM=y
CONFIG_FS_FATFS_LFN=y
# The long-name buffer goes on the heap (512 B per call): FS_FATFS_REENTRANT
# depends on !FS_FATFS_LFN_MODE_BSS, and with BSS Kconfig silently drops it.
CONFIG_FS_FATFS_LFN_MODE_HEAP=y
# FatFs is only thread-safe with REENTRANT (a mutex per volume): SFTP, the
# shell's `ls` (which calls f_stat directly), HTTP PUT and the log backend's
# /SD:/log writes all use the card from different threads.  Without it, a
# 4 MiB SFTP get failed partway with "file read error (-5)".
CONFIG_FS_FATFS_REENTRANT=y
# Open files at once: the log backend keeps one, and an sshfs client has
# several on the go (its CLOSE trails behind the next OPEN).
CONFIG_FS_FATFS_NUM_FILES=16
CONFIG_FS_FATFS_NUM_DIRS=8

# ── Shell (UART console) ─────────────────────────────────────────────────
CONFIG_SHELL=y
CONFIG_SHELL_BACKEND_SERIAL=y
# Log to the UART backend directly, NOT via the shell's log backend.  The shell
# backend processes logs on the shell thread, which is starved during boot/net
# init, so messages buffer and only flush after DHCP.  Driving the UART backend
# from the deferred log thread instead keeps boot/early messages flowing.  (This
# also means logs never appear in the shell/SSH sessions — only on the UART and
# in the SD log files.)
CONFIG_LOG_BACKEND_UART=y
CONFIG_SHELL_LOG_BACKEND=n
# Per-session prompt shows the cwd (set via shell_prompt_change).  40 is the
# Kconfig max for this buffer; cwds longer than ~36 chars are truncated with a
# leading '<' in shell_prompt_sync() (shell_paths.c).
CONFIG_SHELL_PROMPT_CHANGE=y
CONFIG_SHELL_PROMPT_BUFF_SIZE=40
CONFIG_DEVMEM_SHELL=n
CONFIG_KLAUSSCPU_SHELL_CMDS=y

# ── wolfSSL + wolfSSH (built from source as Zephyr modules) ──────────────
CONFIG_WOLFSSL=y
CONFIG_WOLFSSL_BUILTIN=y
CONFIG_WOLFSSL_SETTINGS_FILE="user_settings.h"
CONFIG_WOLFSSH=y
CONFIG_WOLFSSH_SETTINGS_FILE="user_settings.h"
CONFIG_WOLFSSH_SFTP_DEFAULT_DIR="/SD:"

# ── SSH server ────────────────────────────────────────────────────────────
CONFIG_KLAUSSCPU_SSH_SERVER=y
CONFIG_THREAD_MONITOR=y
CONFIG_THREAD_NAME=y
# Per-thread and idle CPU time, for `bench prof` (the PERF block counts WAIT
# cycles as executing, so it can't show idle).
CONFIG_THREAD_RUNTIME_STATS=y
CONFIG_SCHED_THREAD_USAGE=y
CONFIG_SCHED_THREAD_USAGE_ALL=y

# ── HTTP file server (raw socket, :80, serves /SD:) ───────────────────────
# Kernel-resident and auto-started at boot (like httpsd below).  The *backend*
# API logic (/api/*) is the loadable part — webapi.c is a dispatcher to a
# handler that the apibackend.llext extension registers at runtime (svc load).
CONFIG_KLAUSSCPU_HTTP_SERVER=y

# ── HTTPS file server (HTTP over TLS via wolfSSL, :443, serves /SD:) ───────
# Self-signed ECDSA P-256 cert generated on first boot and persisted to /SD:.
# TLS 1.2 + 1.3; reuses the HTTP request dispatch and wolfSSL (already built
# for SSH).
CONFIG_KLAUSSCPU_HTTPS_SERVER=y

# ── VNC (RFB) server (:5900, serves an in-RAM RGB565 framebuffer) ─────────
# Remote graphics without VGA hardware — connect with macOS Screen Sharing,
# TigerVNC or RealVNC.  Currently shows a built-in test pattern.
CONFIG_KLAUSSCPU_VNC_SERVER=y

# Socket/fd/context headroom.  Three TCP listeners (SSH :22, HTTP :80, HTTPS
# :443) + up to SSH_MAX_CONNS (5) SSH sessions + the HTTP/HTTPS accepted sockets
# + DNS/UDP must coexist — and a browser opens several parallel connections and a
# busy dashboard churns connections that linger in TIME_WAIT, so the pools need
# real slack.  Every TCP listener AND connection (incl. TIME_WAIT) consumes a
# net_conn; running out yields "Not enough connection contexts. Consider
# increasing CONFIG_NET_MAX_CONN" and new connections (curl) can't be accepted.
# Sized generously (126 MB RAM); the deeper fix for connection back-pressure is
# concurrent HTTP/HTTPS workers (see plan), but headroom prevents the stall.
CONFIG_ZVFS_OPEN_MAX=48
CONFIG_NET_MAX_CONTEXTS=48
CONFIG_NET_MAX_CONN=48
CONFIG_ZVFS_POLL_MAX=12

# ── LLEXT (runtime-loadable extensions; `run` command) ───────────────────
CONFIG_LLEXT=y
CONFIG_LLEXT_TYPE_ELF_OBJECT=y
CONFIG_LLEXT_HEAP_SIZE=256
# Quiet the per-relocation load trace on the UART; warnings/errors still show.
CONFIG_LLEXT_LOG_LEVEL_WRN=y
# Per-thread stdio routing for concurrent `run`s keys off thread custom data.
CONFIG_THREAD_CUSTOM_DATA=y

# libc malloc arena for extensions (minimal libc defaults this to 0 = no heap).
CONFIG_COMMON_LIBC_MALLOC_ARENA_SIZE=2097152

# ── Memory (126 MB RAM available — be generous) ──────────────────────────
# wolfSSL/wolfSSH allocate here (k_malloc), incl. each SSH channel's 128 KiB
# receive window (user_settings.h DEFAULT_WINDOW_SZ).
CONFIG_HEAP_MEM_POOL_SIZE=4194304
CONFIG_MAIN_STACK_SIZE=32768
CONFIG_SYSTEM_WORKQUEUE_STACK_SIZE=8192
# Shell-core thread stack. Each shell instance (serial + one per SSH slot) gets
# this. `run` executes loaded llext programs on the shell thread, so it must be
# large enough for the program + its callees (was the 40 KB SSH conn stack).
CONFIG_SHELL_STACK_SIZE=40960
# Deferred-mode log thread now also writes to the SD card (FatFs) via the FS
# backend, so it needs more than the 2048 that sufficed for UART-only output.
CONFIG_LOG_PROCESS_THREAD_STACK_SIZE=4096

# ── MicroPython: the `python` command (MICROPYTHON_PLAN.md step 6) ────────
CONFIG_KLAUSSCPU_PYTHON=y
CONFIG_KLAUSSCPU_PYTHON_HEAP_SIZE=1048576
# socket.pkt_get_info() in ports/zephyr/modsocket.c reads the pool counts.
CONFIG_NET_BUF_POOL_USAGE=y
# The SD fstab entry (app.overlay) has `automount` for MicroPython's sake;
# main.c still does the mount, after disk_access_init.
CONFIG_FS_FATFS_FSTAB_AUTOMOUNT=n
```

## app.overlay
```dts
/* The SD card's FatFs volume as a devicetree fstab entry.  main.c mounts it
 * after disk_access_init; being in the fstab also lets MicroPython find it
 * (zephyr.FileSystem('/SD:'), the `python` command).
 *
 * `automount` only sets FS_MOUNT_FLAG_AUTOMOUNT here
 * (CONFIG_FS_FATFS_FSTAB_AUTOMOUNT=n in prj.conf, so Zephyr doesn't mount it
 * at boot).  MicroPython's vfs.mount() needs the flag: without it,
 * ports/zephyr/zephyr_filesystem.c unmounts and remounts a volume that is
 * already mounted, under every open file in ssh_shell. */
/ {
	fstab {
		compatible = "zephyr,fstab";

		sdfs: sdfs {
			compatible = "zephyr,fstab,fatfs";
			mount-point = "/SD:";
			disk-access;
			automount;
		};
	};
};
```

## src/main.c
```c
/*
 * main.c — KlaussCPU Zephyr SSH shell application.
 *
 * Boot: SD card mount → DHCP → NTP time → SSH server → shell on UART.
 */

#include <zephyr/kernel.h>
#include <zephyr/fs/fs.h>
#include <zephyr/storage/disk_access.h>
#include <ff.h>
#include <zephyr/net/net_if.h>
#include <zephyr/net/net_mgmt.h>
#include <zephyr/net/net_ip.h>
#include <zephyr/net/dhcpv4.h>
#include <zephyr/net/sntp.h>
#include <zephyr/logging/log.h>

#include "wallclock.h"

#ifdef CONFIG_KLAUSSCPU_SSH_SERVER
#include "ssh_server.h"
#endif

#ifdef CONFIG_KLAUSSCPU_HTTP_SERVER
#include "httpd.h"
#endif

#ifdef CONFIG_KLAUSSCPU_HTTPS_SERVER
#include "httpsd.h"
#endif

#ifdef CONFIG_KLAUSSCPU_VNC_SERVER
#include "vnc_server.h"
#endif

LOG_MODULE_REGISTER(main, LOG_LEVEL_INF);

/* No RTC on this board, so NTP is the time source for FatFs file timestamps.
 * pool.ntp.org rotates servers, so each sntp_simple() re-resolves to a fresh
 * one — retrying rides past a dud/unreachable pool entry or a dropped reply. */
#define NTP_SERVER       "pool.ntp.org"
#define NTP_TIMEOUT_MS   3000
#define NTP_BOOT_TRIES   3

/* ── FatFS mount ─────────────────────────────────────────────────────────── */

/* The mount (FatFs data, "/SD:") is the devicetree fstab entry (app.overlay),
 * defined by Zephyr's fat_fs.c. */
#define SD_FSTAB DT_NODELABEL(sdfs)
FS_FSTAB_DECLARE_ENTRY(SD_FSTAB);

static int mount_sd(void)
{
	int rc = disk_access_init("SD");

	if (rc != 0) {
		LOG_ERR("SD init failed: %d", rc);
		return rc;
	}

	rc = fs_mount(&FS_FSTAB_ENTRY(SD_FSTAB));
	if (rc != 0) {
		LOG_ERR("FatFS mount failed: %d", rc);
		return rc;
	}

	LOG_INF("SD card mounted at /SD:/");
	return 0;
}

/* ── DHCP ────────────────────────────────────────────────────────────────── */

static struct net_mgmt_event_callback dhcp_cb;
static struct k_sem dhcp_sem;

static void dhcp_handler(struct net_mgmt_event_callback *cb,
			 uint64_t mgmt_event, struct net_if *iface)
{
	if (mgmt_event != NET_EVENT_IPV4_DHCP_BOUND) {
		return;
	}

	char addr_str[NET_IPV4_ADDR_LEN];
	struct net_if_config *cfg = net_if_get_config(iface);

	if (cfg && cfg->ip.ipv4) {
		net_addr_ntop(AF_INET,
			      &cfg->ip.ipv4->unicast[0].ipv4.address.in_addr,
			      addr_str, sizeof(addr_str));
		LOG_INF("DHCP: %s", addr_str);
	}

	k_sem_give(&dhcp_sem);
}

static int wait_for_dhcp(void)
{
	k_sem_init(&dhcp_sem, 0, 1);

	net_mgmt_init_event_callback(&dhcp_cb, dhcp_handler,
				     NET_EVENT_IPV4_DHCP_BOUND);
	net_mgmt_add_event_callback(&dhcp_cb);

	struct net_if *iface = net_if_get_default();

	if (!iface) {
		LOG_ERR("No network interface");
		return -1;
	}

	net_dhcpv4_start(iface);

	if (k_sem_take(&dhcp_sem, K_SECONDS(10)) != 0) {
		LOG_WRN("DHCP timeout");
		return -1;
	}
	return 0;
}

/* ── Main ────────────────────────────────────────────────────────────────── */

int main(void)
{
	LOG_INF("KlaussCPU Zephyr SSH Shell");

	int sd_ok = (mount_sd() == 0);
	int net_ok = (wait_for_dhcp() == 0);

	/* Best-effort time at boot; the `ntp` shell command can re-sync, and
	 * `date <unix_epoch>` sets it manually. */
	if (net_ok) {
		struct sntp_time ts;
		bool got = false;

		for (int i = 0; i < NTP_BOOT_TRIES; i++) {
			if (sntp_simple(NTP_SERVER, NTP_TIMEOUT_MS, &ts) == 0) {
				wallclock_set(ts.seconds);
				LOG_INF("NTP: time set from %s", NTP_SERVER);
				got = true;
				break;
			}
		}

		if (!got) {
			LOG_WRN("NTP failed at boot; use `ntp [server]` or "
				"`date <unix_epoch>`");
		}
	}

#ifdef CONFIG_KLAUSSCPU_SSH_SERVER
	if (net_ok && sd_ok) {
		if (ssh_server_start() == 0) {
			LOG_INF("SSH ready on port 22");
		} else {
			LOG_ERR("SSH server failed");
		}
	}
#endif

#ifdef CONFIG_KLAUSSCPU_HTTP_SERVER
	if (net_ok && sd_ok) {
		httpd_start();
		LOG_INF("HTTP file server ready on port 80");
	}
#endif

#ifdef CONFIG_KLAUSSCPU_HTTPS_SERVER
	if (net_ok && sd_ok) {
		if (httpsd_start() == 0) {
			LOG_INF("HTTPS file server ready on port 443");
		} else {
			LOG_ERR("HTTPS server failed");
		}
	}
#endif

#ifdef CONFIG_KLAUSSCPU_VNC_SERVER
	if (net_ok) {
		vnc_server_start();
		LOG_INF("VNC server ready on port 5900");
	}
#endif

	LOG_INF("System ready");

	while (1) {
		k_sleep(K_SECONDS(60));
	}
	return 0;
}
```
