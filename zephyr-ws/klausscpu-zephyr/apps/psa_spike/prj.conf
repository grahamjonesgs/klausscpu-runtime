## CMakeLists.txt
```
cmake_minimum_required(VERSION 3.20)

find_package(Zephyr REQUIRED HINTS $ENV{ZEPHYR_BASE})
project(psa_spike)

target_sources(app PRIVATE src/main.c)
```

## Kconfig
```
mainmenu "psa_spike"

config PSA_SPIKE_BOOT_BENCH
	bool "Run the PSA benchmark on the UART at boot instead of starting SSH"
	help
	  Prints the psabench results with printk and then idles: no network,
	  no host key, no SSH server.

config PSA_SPIKE_HOST_KEY_ECDSA
	bool "ECDSA P-256 host key (RSA-2048 otherwise)"
	default y
	select SSH_HOST_KEY_ECDSA

source "Kconfig.zephyr"
```

## prj.conf
```kconfig
# psa_spike: Zephyr's SSH server on mbedTLS / PSA, and a benchmark of the PSA
# operations SSH and TLS use (ZEPHYR_4_5_PLAN.md step 6).

# ── Core ─────────────────────────────────────────────────────────────────────
CONFIG_XIP=n
CONFIG_CBPRINTF_FP_SUPPORT=n
CONFIG_CBPRINTF_FP_A_SUPPORT=n
CONFIG_UART_KLAUSSCPU=y
CONFIG_UART_CONSOLE=y
CONFIG_CONSOLE=y
CONFIG_PRINTK=y
CONFIG_KLAUSSCPU_TIMER=y
CONFIG_LOG=y
CONFIG_LOG_BACKEND_UART=y
CONFIG_LOG_MODE_IMMEDIATE=y
CONFIG_THREAD_NAME=y
CONFIG_STACK_SENTINEL=y
CONFIG_MAIN_STACK_SIZE=32768
CONFIG_SYSTEM_WORKQUEUE_STACK_SIZE=8192
CONFIG_SHELL_STACK_SIZE=32768
CONFIG_COMMON_LIBC_MALLOC_ARENA_SIZE=-1
CONFIG_HEAP_MEM_POOL_SIZE=1048576
CONFIG_MINIMAL_LIBC_OPTIMIZE_STRING_FOR_SIZE=n

# ── Networking (as apps/mandel) ──────────────────────────────────────────────
CONFIG_NETWORKING=y
CONFIG_NET_L2_ETHERNET=y
CONFIG_ETH_KLAUSSCPU=y
CONFIG_NET_IPV4=y
CONFIG_NET_IPV6=n
CONFIG_NET_DHCPV4=y
CONFIG_NET_SOCKETS=y
CONFIG_NET_TCP=y
CONFIG_NET_UDP=y
CONFIG_NET_TCP_MAX_SEND_WINDOW_SIZE=32768
CONFIG_NET_TCP_MAX_RECV_WINDOW_SIZE=32768
CONFIG_NET_RX_STACK_SIZE=8192
CONFIG_NET_TX_STACK_SIZE=8192
CONFIG_NET_SOCKETS_SERVICE_STACK_SIZE=8192
CONFIG_NET_MGMT_EVENT_STACK_SIZE=8192
CONFIG_NET_TCP_WORKQ_STACK_SIZE=8192
CONFIG_NET_PKT_RX_COUNT=64
CONFIG_NET_PKT_TX_COUNT=48
CONFIG_NET_BUF_RX_COUNT=96
CONFIG_NET_BUF_TX_COUNT=64
CONFIG_NET_MAX_CONTEXTS=24
CONFIG_NET_MAX_CONN=24
CONFIG_ZVFS_OPEN_MAX=16
CONFIG_ZVFS_POLL_MAX=10

# ── Shell and Zephyr's SSH server ────────────────────────────────────────────
CONFIG_SHELL=y
CONFIG_NET_SHELL=y
CONFIG_SSH_SERVER=y
CONFIG_SSH_SERVER_MAX_CLIENTS=2
CONFIG_SSH_MAX_CHANNELS=2
CONFIG_SSH_MAX_HOST_KEYS=2
CONFIG_SSH_SERVER_SHELL_COUNT=1

# ── mbedTLS / PSA: what SSH and TLS 1.3 use, plus the alternatives measured ──
CONFIG_MBEDTLS=y
CONFIG_PSA_CRYPTO=y
CONFIG_PSA_WANT_KEY_TYPE_AES=y
CONFIG_PSA_WANT_ALG_CTR=y
CONFIG_PSA_WANT_ALG_GCM=y
CONFIG_PSA_WANT_ALG_SHA_256=y
CONFIG_PSA_WANT_ALG_HMAC=y
CONFIG_PSA_WANT_KEY_TYPE_HMAC=y
CONFIG_PSA_WANT_KEY_TYPE_RSA_KEY_PAIR_GENERATE=y
CONFIG_PSA_WANT_ALG_RSA_PKCS1V15_SIGN=y
CONFIG_PSA_WANT_ECC_SECP_R1_256=y
CONFIG_PSA_WANT_ALG_ECDSA=y
CONFIG_PSA_WANT_KEY_TYPE_ECC_KEY_PAIR_GENERATE=y
CONFIG_PSA_WANT_ECC_MONTGOMERY_255=y
CONFIG_PSA_WANT_ALG_ECDH=y
```

## src/main.c
```c
/* psa_spike — Zephyr's SSH server on mbedTLS / PSA on KlaussCPU, and a
 * benchmark of the PSA operations SSH and TLS use (ZEPHYR_4_5_PLAN.md step 6).
 *
 * Boot: DHCP, an RSA-2048 host key (timed), then the SSH server on :22 with
 * user admin / password klausscpu and a shell.  `psabench` (UART or SSH)
 * times each operation in software, or through a PSA driver once one exists.
 */

#include <stdlib.h>
#include <string.h>

#include <zephyr/kernel.h>
#include <zephyr/logging/log.h>
#include <zephyr/net/net_if.h>
#include <zephyr/net/net_mgmt.h>
#include <zephyr/net/dhcpv4.h>
#include <zephyr/net/socket.h>
#include <zephyr/net/ssh/keygen.h>
#include <zephyr/net/ssh/server.h>
#include <zephyr/shell/shell.h>
#include <zephyr/shell/shell_ssh.h>
#include <psa/crypto.h>

LOG_MODULE_REGISTER(psa_spike, LOG_LEVEL_INF);

#include "rsa_test_key.h"

/* Results go to the shell that ran psabench, or to printk at boot. */
static const struct shell *bench_sh;
#define P(...)                                                                     \
	do {                                                                       \
		if (bench_sh) {                                                    \
			shell_print(bench_sh, __VA_ARGS__);                        \
		} else {                                                           \
			printk(__VA_ARGS__);                                       \
			printk("\n");                                              \
		}                                                                  \
	} while (0)

#define HOST_KEY_INDEX 0

static struct net_mgmt_event_callback dhcp_cb;
static struct k_sem dhcp_sem;

static void dhcp_handler(struct net_mgmt_event_callback *cb, uint64_t mgmt_event,
			 struct net_if *iface)
{
	ARG_UNUSED(cb);
	ARG_UNUSED(iface);
	if (mgmt_event == NET_EVENT_IPV4_DHCP_BOUND) {
		k_sem_give(&dhcp_sem);
	}
}

static int wait_for_dhcp(void)
{
	struct net_if *iface = net_if_get_default();

	k_sem_init(&dhcp_sem, 0, 1);
	net_mgmt_init_event_callback(&dhcp_cb, dhcp_handler, NET_EVENT_IPV4_DHCP_BOUND);
	net_mgmt_add_event_callback(&dhcp_cb);
	if (!iface) {
		return -ENODEV;
	}
	net_dhcpv4_start(iface);
	return k_sem_take(&dhcp_sem, K_SECONDS(15));
}

/* ── benchmark ──────────────────────────────────────────────────────────── */

#define BUF 16384
static uint8_t in_buf[BUF], out_buf[BUF + 64];

static uint64_t us_since(uint64_t t0)
{
	return (k_cycle_get_64() - t0) / (sys_clock_hw_cycles_per_sec() / 1000000u);
}

static unsigned long kibps(size_t bytes, uint64_t us)
{
	return us ? (unsigned long)((uint64_t)bytes * 1000000u / us / 1024u) : 0;
}

static psa_key_id_t import_sym(psa_key_type_t type, psa_algorithm_t alg,
			       psa_key_usage_t usage, size_t bytes)
{
	psa_key_attributes_t a = PSA_KEY_ATTRIBUTES_INIT;
	uint8_t key[32];
	psa_key_id_t id = 0;

	psa_generate_random(key, bytes);
	psa_set_key_type(&a, type);
	psa_set_key_algorithm(&a, alg);
	psa_set_key_usage_flags(&a, usage);
	psa_set_key_bits(&a, bytes * 8);
	if (psa_import_key(&a, key, bytes, &id) != PSA_SUCCESS) {
		return 0;
	}
	return id;
}

static psa_key_id_t gen_asym(psa_key_type_t type, size_t bits, psa_algorithm_t alg,
			     psa_key_usage_t usage, uint64_t *us)
{
	psa_key_attributes_t a = PSA_KEY_ATTRIBUTES_INIT;
	psa_key_id_t id = 0;
	uint64_t t0 = k_cycle_get_64();

	psa_set_key_type(&a, type);
	psa_set_key_bits(&a, bits);
	psa_set_key_algorithm(&a, alg);
	psa_set_key_usage_flags(&a, usage);
	if (psa_generate_key(&a, &id) != PSA_SUCCESS) {
		return 0;
	}
	*us = us_since(t0);
	return id;
}

/* Known answers through the PSA API, whichever driver serves them. */
static int check_eq(const char *name, const uint8_t *got, const char *want_hex)
{
	uint8_t want[32];

	for (int i = 0; i < 32; i++) {
		unsigned int b;
		char t[3] = {want_hex[2 * i], want_hex[2 * i + 1], 0};

		b = (unsigned int)strtoul(t, NULL, 16);
		want[i] = (uint8_t)b;
	}
	bool ok = memcmp(got, want, 32) == 0;

	P("%s  %s", ok ? "PASS" : "FAIL", name);
	return ok ? 0 : 1;
}

static int psacheck(void)
{
	static uint8_t a_chunk[1000];
	uint8_t d[32], d2[32];
	size_t olen;
	int fails = 0;
	psa_hash_operation_t op = PSA_HASH_OPERATION_INIT, op2 = PSA_HASH_OPERATION_INIT;

	psa_hash_compute(PSA_ALG_SHA_256, (const uint8_t *)"abc", 3, d, sizeof(d), &olen);
	fails += check_eq("SHA-256(\"abc\")", d,
			  "ba7816bf8f01cfea414140de5dae2223b00361a396177a9cb410ff61f20015ad");

	/* 1,000,000 x 'a' in chunks of 1..1000 bytes, interleaved with a
	 * second operation hashing "abc". */
	memset(a_chunk, 'a', sizeof(a_chunk));
	psa_hash_setup(&op, PSA_ALG_SHA_256);
	psa_hash_setup(&op2, PSA_ALG_SHA_256);
	psa_hash_update(&op2, (const uint8_t *)"a", 1);
	size_t done = 0, n = 1;

	while (done < 1000000) {
		size_t take = MIN(n, 1000000 - done);

		psa_hash_update(&op, a_chunk, take);
		done += take;
		n = n % 963 + 37;   /* 37..999: within a_chunk */
	}
	psa_hash_update(&op2, (const uint8_t *)"bc", 2);
	psa_hash_finish(&op, d, sizeof(d), &olen);
	psa_hash_finish(&op2, d2, sizeof(d2), &olen);
	fails += check_eq("SHA-256(10^6 x 'a'), odd chunks", d,
			  "cdc76e5c9914fb9281a1c7e284d73e67f1809a48a497200e046d39ccc7112cd0");
	fails += check_eq("SHA-256 interleaved with it", d2,
			  "ba7816bf8f01cfea414140de5dae2223b00361a396177a9cb410ff61f20015ad");

	/* RFC 4231 test cases 1 and 2. */
	static const struct { uint8_t key[20]; size_t klen; const char *msg; const char *mac; } tc[] = {
		{ {0x0b, 0x0b, 0x0b, 0x0b, 0x0b, 0x0b, 0x0b, 0x0b, 0x0b, 0x0b,
		   0x0b, 0x0b, 0x0b, 0x0b, 0x0b, 0x0b, 0x0b, 0x0b, 0x0b, 0x0b}, 20, "Hi There",
		  "b0344c61d8db38535ca8afceaf0bf12b881dc200c9833da726e9376c2e32cff7" },
		{ {'J', 'e', 'f', 'e'}, 4, "what do ya want for nothing?",
		  "5bdcc146bf60754e6a042426089575c75a003f089d2739839dec58b964ec3843" },
	};
	for (int t = 0; t < 2; t++) {
		psa_key_attributes_t a = PSA_KEY_ATTRIBUTES_INIT;
		psa_key_id_t k;
		char name[32];

		psa_set_key_type(&a, PSA_KEY_TYPE_HMAC);
		psa_set_key_algorithm(&a, PSA_ALG_HMAC(PSA_ALG_SHA_256));
		psa_set_key_usage_flags(&a, PSA_KEY_USAGE_SIGN_MESSAGE);
		psa_import_key(&a, tc[t].key, tc[t].klen, &k);
		psa_mac_compute(k, PSA_ALG_HMAC(PSA_ALG_SHA_256), (const uint8_t *)tc[t].msg,
				strlen(tc[t].msg), d, sizeof(d), &olen);
		psa_destroy_key(k);
		snprintk(name, sizeof(name), "HMAC-SHA-256 RFC 4231 TC%d", t + 1);
		fails += check_eq(name, d, tc[t].mac);
	}
	/* AES-128-CTR, SP 800-38A F.5.1, through the multi-part API split at
	 * 7 / 50 / 7 bytes (a partial block's keystream carried over), then the
	 * one-shot decrypt of IV || ciphertext. */
	{
		static const uint8_t key[16] = {0x2b, 0x7e, 0x15, 0x16, 0x28, 0xae, 0xd2, 0xa6,
						0xab, 0xf7, 0x15, 0x88, 0x09, 0xcf, 0x4f, 0x3c};
		static const uint8_t icb[16] = {0xf0, 0xf1, 0xf2, 0xf3, 0xf4, 0xf5, 0xf6, 0xf7,
						0xf8, 0xf9, 0xfa, 0xfb, 0xfc, 0xfd, 0xfe, 0xff};
		static const char *pt_hex = "6bc1bee22e409f96e93d7e117393172aae2d8a571e03ac9c9eb76fac45af8e51"
					    "30c81c46a35ce411e5fbc1191a0a52eff69f2445df4f9b17ad2b417be66c3710";
		static const char *ct_hex = "874d6191b620e3261bef6864990db6ce9806f66b7970fdff8617187bb9fffdff"
					    "5ae4df3edbd5d35e5b4f09020db03eab1e031dda2fbe03d1792170a0f3009cee";
		uint8_t pt[64], ct[64], buf[80];
		psa_key_attributes_t a = PSA_KEY_ATTRIBUTES_INIT;
		psa_cipher_operation_t cop = PSA_CIPHER_OPERATION_INIT;
		psa_key_id_t k;
		size_t o1 = 0, o2 = 0, o3 = 0, o4 = 0;

		for (int i = 0; i < 64; i++) {
			char t1[3] = {pt_hex[2 * i], pt_hex[2 * i + 1], 0};
			char t2[3] = {ct_hex[2 * i], ct_hex[2 * i + 1], 0};

			pt[i] = (uint8_t)strtoul(t1, NULL, 16);
			ct[i] = (uint8_t)strtoul(t2, NULL, 16);
		}
		psa_set_key_type(&a, PSA_KEY_TYPE_AES);
		psa_set_key_algorithm(&a, PSA_ALG_CTR);
		psa_set_key_usage_flags(&a, PSA_KEY_USAGE_ENCRYPT | PSA_KEY_USAGE_DECRYPT);
		psa_import_key(&a, key, 16, &k);
		psa_cipher_encrypt_setup(&cop, k, PSA_ALG_CTR);
		psa_cipher_set_iv(&cop, icb, 16);
		psa_cipher_update(&cop, pt, 7, buf, sizeof(buf), &o1);
		psa_cipher_update(&cop, pt + 7, 50, buf + o1, sizeof(buf) - o1, &o2);
		psa_cipher_update(&cop, pt + 57, 7, buf + o1 + o2, sizeof(buf) - o1 - o2, &o3);
		psa_cipher_finish(&cop, buf + o1 + o2 + o3, sizeof(buf), &o4);
		bool ok = o1 + o2 + o3 + o4 == 64 && memcmp(buf, ct, 64) == 0;

		P("%s  AES-128-CTR F.5.1, multi-part 7/50/7", ok ? "PASS" : "FAIL");
		fails += !ok;
		memcpy(buf, icb, 16);
		memcpy(buf + 16, ct, 64);
		uint8_t back[64];

		psa_cipher_decrypt(k, PSA_ALG_CTR, buf, 80, back, sizeof(back), &o1);
		ok = o1 == 64 && memcmp(back, pt, 64) == 0;
		P("%s  AES-128-CTR F.5.1, one-shot decrypt", ok ? "PASS" : "FAIL");
		fails += !ok;
		psa_destroy_key(k);
	}
	/* X25519, RFC 7748 6.1: Alice's private key with Bob's public key. */
	{
		static const char *a_priv = "77076d0a7318a57d3c16c17251b26645df4c2f87ebc0992ab177fba51db92c2a";
		static const char *b_pub  = "de9edb7d7b7dc1b4d35b61c2ece435373f8343c85b78674dadfc7e146f882b4f";
		static const char *shared = "4a5d9d5ba4ce2de1728e3bf480350f25e07e21c947d19e3376f09b3c1e161742";
		uint8_t priv[32], pub[32], out[32];
		psa_key_attributes_t a = PSA_KEY_ATTRIBUTES_INIT;
		psa_key_id_t k;

		for (int i = 0; i < 32; i++) {
			char t1[3] = {a_priv[2 * i], a_priv[2 * i + 1], 0};
			char t2[3] = {b_pub[2 * i], b_pub[2 * i + 1], 0};

			priv[i] = (uint8_t)strtoul(t1, NULL, 16);
			pub[i] = (uint8_t)strtoul(t2, NULL, 16);
		}
		psa_set_key_type(&a, PSA_KEY_TYPE_ECC_KEY_PAIR(PSA_ECC_FAMILY_MONTGOMERY));
		psa_set_key_bits(&a, 255);
		psa_set_key_algorithm(&a, PSA_ALG_ECDH);
		psa_set_key_usage_flags(&a, PSA_KEY_USAGE_DERIVE);
		psa_import_key(&a, priv, 32, &k);
		psa_set_key_usage_flags(&a, PSA_KEY_USAGE_DERIVE | PSA_KEY_USAGE_EXPORT);
		psa_key_id_t k2;

		psa_import_key(&a, priv, 32, &k2);
		memset(out, 0, sizeof(out));
		psa_raw_key_agreement(PSA_ALG_ECDH, k, pub, 32, out, sizeof(out), &olen);
		psa_destroy_key(k);
		fails += check_eq("X25519 RFC 7748 6.1 shared secret", out, shared);
		memset(out, 0, sizeof(out));
		psa_export_public_key(k2, out, sizeof(out), &olen);
		psa_destroy_key(k2);
		fails += check_eq("X25519 RFC 7748 6.1 Alice public key", out,
				  "8520f0098930a754748b7ddcb43ef75a0dbf3a0d26381af4eba4a98eaa9b4e6a");
	}
	P("psacheck: %d failure(s)", fails);
	return fails;
}

static void psabench(bool asym, bool keygen)
{
	uint8_t hash[32], sig[512], pub[160], secret[64], tag[16], iv[12];
	size_t olen;
	uint64_t t0, us;
	psa_status_t st;
	psa_key_id_t k;
	const int reps = 4;

	psa_generate_random(in_buf, BUF);
	psa_generate_random(hash, sizeof(hash));

	/* Bulk: SSH's only cipher (aes128-ctr + hmac-sha2-256) and TLS 1.3's GCM. */
	k = import_sym(PSA_KEY_TYPE_AES, PSA_ALG_CTR, PSA_KEY_USAGE_ENCRYPT, 16);
	t0 = k_cycle_get_64();
	for (int i = 0; i < reps; i++) {
		st = psa_cipher_encrypt(k, PSA_ALG_CTR, in_buf, BUF, out_buf, sizeof(out_buf),
					&olen);
	}
	us = us_since(t0);
	P("AES-128-CTR      16 KiB  %6lu KiB/s  (status %d)",
		    kibps(BUF * reps, us), st);
	psa_destroy_key(k);

	k = import_sym(PSA_KEY_TYPE_AES, PSA_ALG_GCM, PSA_KEY_USAGE_ENCRYPT, 16);
	psa_generate_random(iv, sizeof(iv));
	t0 = k_cycle_get_64();
	for (int i = 0; i < reps; i++) {
		st = psa_aead_encrypt(k, PSA_ALG_GCM, iv, sizeof(iv), NULL, 0, in_buf, BUF,
				      out_buf, sizeof(out_buf), &olen);
	}
	us = us_since(t0);
	P("AES-128-GCM      16 KiB  %6lu KiB/s  (status %d)",
		    kibps(BUF * reps, us), st);
	psa_destroy_key(k);

	t0 = k_cycle_get_64();
	for (int i = 0; i < reps; i++) {
		st = psa_hash_compute(PSA_ALG_SHA_256, in_buf, BUF, hash, sizeof(hash), &olen);
	}
	us = us_since(t0);
	P("SHA-256          16 KiB  %6lu KiB/s  (status %d)",
		    kibps(BUF * reps, us), st);

	k = import_sym(PSA_KEY_TYPE_HMAC, PSA_ALG_HMAC(PSA_ALG_SHA_256),
		       PSA_KEY_USAGE_SIGN_MESSAGE, 32);
	t0 = k_cycle_get_64();
	for (int i = 0; i < reps; i++) {
		st = psa_mac_compute(k, PSA_ALG_HMAC(PSA_ALG_SHA_256), in_buf, BUF, tag,
				     sizeof(hash), &olen);
	}
	us = us_since(t0);
	P("HMAC-SHA-256     16 KiB  %6lu KiB/s  (status %d)",
		    kibps(BUF * reps, us), st);
	t0 = k_cycle_get_64();
	for (int i = 0; i < 64; i++) {
		st = psa_mac_compute(k, PSA_ALG_HMAC(PSA_ALG_SHA_256), in_buf, 64, out_buf,
				     32, &olen);
	}
	us = us_since(t0);
	P("HMAC-SHA-256     64 B    %6lu us each", (unsigned long)(us / 64));
	psa_destroy_key(k);

	if (!asym) {
		return;
	}

	/* Key exchange: curve25519-sha256 (SSH), x25519 (TLS 1.3). */
	k = gen_asym(PSA_KEY_TYPE_ECC_KEY_PAIR(PSA_ECC_FAMILY_MONTGOMERY), 255, PSA_ALG_ECDH,
		     PSA_KEY_USAGE_DERIVE, &us);
	P("X25519 keygen            %6lu us", (unsigned long)us);
	psa_export_public_key(k, pub, sizeof(pub), &olen);
	t0 = k_cycle_get_64();
	st = psa_raw_key_agreement(PSA_ALG_ECDH, k, pub, olen, secret, sizeof(secret), &olen);
	P("X25519 agreement         %6lu us  (status %d)",
		    (unsigned long)us_since(t0), st);
	psa_destroy_key(k);

	/* Host keys: rsa-sha2-256 (all Zephyr's SSH offers), ECDSA P-256 (TLS
	 * cert, and the alternative SSH host key). */
	k = gen_asym(PSA_KEY_TYPE_ECC_KEY_PAIR(PSA_ECC_FAMILY_SECP_R1), 256,
		     PSA_ALG_ECDSA(PSA_ALG_SHA_256),
		     PSA_KEY_USAGE_SIGN_HASH | PSA_KEY_USAGE_VERIFY_HASH, &us);
	P("ECDSA P-256 keygen       %6lu us", (unsigned long)us);
	t0 = k_cycle_get_64();
	st = psa_sign_hash(k, PSA_ALG_ECDSA(PSA_ALG_SHA_256), hash, sizeof(hash), sig,
			   sizeof(sig), &olen);
	P("ECDSA P-256 sign         %6lu us  (status %d)",
		    (unsigned long)us_since(t0), st);
	t0 = k_cycle_get_64();
	st = psa_verify_hash(k, PSA_ALG_ECDSA(PSA_ALG_SHA_256), hash, sizeof(hash), sig, olen);
	P("ECDSA P-256 verify       %6lu us  (status %d)",
		    (unsigned long)us_since(t0), st);
	psa_destroy_key(k);

	/* RSA-2048 signing on a fixed test key (rsa_test_key.h): the
	 * rsa-sha2-256 host key signature every Zephyr SSH handshake makes. */
	{
		psa_key_attributes_t a = PSA_KEY_ATTRIBUTES_INIT;

		psa_set_key_type(&a, PSA_KEY_TYPE_RSA_KEY_PAIR);
		psa_set_key_algorithm(&a, PSA_ALG_RSA_PKCS1V15_SIGN(PSA_ALG_SHA_256));
		psa_set_key_usage_flags(&a, PSA_KEY_USAGE_SIGN_HASH | PSA_KEY_USAGE_VERIFY_HASH);
		st = psa_import_key(&a, rsa_test_key, sizeof(rsa_test_key), &k);
		if (st != PSA_SUCCESS) {
			P("RSA-2048 import failed (status %d)", st);
			return;
		}
	}
	t0 = k_cycle_get_64();
	st = psa_sign_hash(k, PSA_ALG_RSA_PKCS1V15_SIGN(PSA_ALG_SHA_256), hash, sizeof(hash),
			   sig, sizeof(sig), &olen);
	P("RSA-2048 sign            %6lu us  (status %d)", (unsigned long)us_since(t0), st);
	t0 = k_cycle_get_64();
	st = psa_verify_hash(k, PSA_ALG_RSA_PKCS1V15_SIGN(PSA_ALG_SHA_256), hash, sizeof(hash),
			     sig, olen);
	P("RSA-2048 verify          %6lu us  (status %d)", (unsigned long)us_since(t0), st);
	psa_destroy_key(k);

	if (keygen) {
		k = gen_asym(PSA_KEY_TYPE_RSA_KEY_PAIR, 2048,
			     PSA_ALG_RSA_PKCS1V15_SIGN(PSA_ALG_SHA_256), PSA_KEY_USAGE_SIGN_HASH,
			     &us);
		P("RSA-2048 keygen          %6lu ms", (unsigned long)(us / 1000));
		psa_destroy_key(k);
	}
}

static int cmd_psabench(const struct shell *sh, size_t argc, char **argv)
{
	bench_sh = sh;
	psabench(argc < 2 || strcmp(argv[1], "sym") != 0,
		 argc >= 2 && strcmp(argv[1], "keygen") == 0);
	bench_sh = NULL;
	return 0;
}

static int cmd_psacheck(const struct shell *sh, size_t argc, char **argv)
{
	bench_sh = sh;
	psacheck();
	bench_sh = NULL;
	return 0;
}

SHELL_CMD_REGISTER(psacheck, NULL, "Known-answer tests through the PSA API", cmd_psacheck);

SHELL_CMD_ARG_REGISTER(psabench, NULL,
		       "Time PSA operations (sym: symmetric only; keygen: add RSA-2048 keygen)",
		       cmd_psabench, 1, 1);

int main(void)
{
	static struct net_sockaddr_in bind_addr;
	uint64_t t0;
	int ret;

	printk("\nKlaussCPU psa_spike: Zephyr SSH on mbedTLS\n");
	ret = psa_crypto_init();
	if (ret != PSA_SUCCESS) {
		LOG_ERR("psa_crypto_init: %d", ret);
	}
	if (IS_ENABLED(CONFIG_PSA_SPIKE_BOOT_BENCH)) {
		psacheck();
		psabench(true, false);
		printk("psabench done\n");
		k_sleep(K_FOREVER);
	}
	if (wait_for_dhcp() != 0) {
		LOG_WRN("no DHCP lease");
	}

	t0 = k_cycle_get_64();
#ifdef CONFIG_PSA_SPIKE_HOST_KEY_ECDSA
	ret = ssh_keygen(HOST_KEY_INDEX, SSH_HOST_KEY_TYPE_ECDSA_P256, 256);
	LOG_INF("host key: ECDSA P-256 generated in %lu ms (%d)",
		(unsigned long)(us_since(t0) / 1000), ret);
#else
	ret = ssh_keygen(HOST_KEY_INDEX, SSH_HOST_KEY_TYPE_RSA, 2048);
	LOG_INF("host key: RSA-2048 generated in %lu ms (%d)",
		(unsigned long)(us_since(t0) / 1000), ret);
#endif

	bind_addr.sin_family = NET_AF_INET;
	bind_addr.sin_port = net_htons(22);
	ret = ssh_server_start(ssh_server_instance(0), (struct net_sockaddr *)&bind_addr,
			       HOST_KEY_INDEX, "admin", "klausscpu", NULL, 0,
			       shell_sshd_event_callback,
			       shell_sshd_transport_event_callback, NULL);
	LOG_INF("SSH listening on port 22 (%d)", ret);

	/* Never return from main on this arch (thread exit jumps to PC 0). */
	k_sleep(K_FOREVER);
	return 0;
}
```

## src/rsa_test_key.h
```c
/* A fixed RSA-2048 key (PKCS#1 DER) for timing signatures only: public, not a secret. */
static const unsigned char rsa_test_key[] = {
  0x30, 0x82, 0x04, 0xa3, 0x02, 0x01, 0x00, 0x02, 0x82, 0x01, 0x01, 0x00,
  0x9e, 0xa4, 0x37, 0xee, 0xee, 0x67, 0xf2, 0x82, 0x54, 0x18, 0x22, 0x51,
  0x4a, 0x66, 0x83, 0xec, 0x52, 0x64, 0xc9, 0xa0, 0x79, 0xed, 0x04, 0xd8,
  0xfc, 0xe9, 0x37, 0xf4, 0xe1, 0x75, 0x78, 0xa4, 0xc1, 0xbf, 0x89, 0x76,
  0x01, 0x20, 0xb7, 0x80, 0x41, 0xe7, 0xbf, 0x07, 0xa6, 0xa3, 0xe3, 0xe1,
  0xac, 0x45, 0xa3, 0xf8, 0x52, 0x84, 0xc0, 0x23, 0xeb, 0x17, 0x78, 0x69,
  0xf4, 0x50, 0xdd, 0xf7, 0xe5, 0xa0, 0x51, 0x91, 0xab, 0xeb, 0x52, 0x64,
  0xfc, 0x5b, 0xe3, 0x07, 0x46, 0x80, 0x2a, 0x9c, 0x62, 0x6f, 0x88, 0xe1,
  0x35, 0x9e, 0x38, 0xf1, 0x71, 0x53, 0x04, 0x21, 0x6c, 0x80, 0x02, 0x04,
  0x79, 0xb1, 0x65, 0xf6, 0x38, 0x88, 0x05, 0x02, 0xb1, 0xed, 0x34, 0x0c,
  0x48, 0x53, 0xe8, 0xaf, 0x53, 0x85, 0x65, 0xf0, 0xb3, 0xe6, 0xe8, 0x6f,
  0xaf, 0xc0, 0x64, 0x52, 0xd7, 0xb8, 0xf3, 0x1f, 0x0c, 0x46, 0xd0, 0xce,
  0xc3, 0xb4, 0xc6, 0xfc, 0x5b, 0xf1, 0xfe, 0x66, 0xb7, 0xc0, 0xde, 0x0d,
  0x4b, 0x9a, 0x8e, 0xd1, 0xad, 0x90, 0xf2, 0xda, 0x83, 0xa4, 0x90, 0x0a,
  0xd4, 0xd8, 0x86, 0xe2, 0xec, 0xae, 0xbf, 0x1e, 0x59, 0x36, 0x5c, 0xd6,
  0xee, 0xcb, 0xc2, 0xae, 0xb7, 0xeb, 0xd7, 0x16, 0x8a, 0xf1, 0xe5, 0x3b,
  0x0f, 0x06, 0xe1, 0x63, 0xe0, 0xe7, 0x9c, 0x10, 0x5c, 0xf6, 0x35, 0x6f,
  0x5e, 0x40, 0x71, 0x43, 0x8a, 0x6a, 0xb5, 0xa3, 0xcf, 0x18, 0xc7, 0xaf,
  0x16, 0xc3, 0x32, 0x29, 0x48, 0x04, 0xe0, 0x4c, 0xcc, 0x00, 0x26, 0x2d,
  0x9a, 0xda, 0x5b, 0x90, 0xb9, 0x9e, 0x28, 0x23, 0x29, 0x29, 0x9b, 0xf3,
  0x4d, 0xd7, 0xc0, 0xa0, 0x45, 0x10, 0x8e, 0xb7, 0x91, 0xe1, 0x88, 0xe5,
  0x8f, 0x69, 0x37, 0x38, 0x87, 0xb7, 0x71, 0x5d, 0xd7, 0xf5, 0xb9, 0x2e,
  0xb3, 0xf0, 0xac, 0x6d, 0x02, 0x03, 0x01, 0x00, 0x01, 0x02, 0x82, 0x01,
  0x00, 0x19, 0x5e, 0x70, 0xfc, 0x62, 0x3f, 0x18, 0xb2, 0x9b, 0x40, 0x95,
  0xc2, 0x52, 0xa7, 0xc4, 0xaa, 0x76, 0xbd, 0x9b, 0xd9, 0xb0, 0x0d, 0xc5,
  0x63, 0xee, 0xc3, 0xdb, 0xd9, 0x2a, 0xf1, 0xc6, 0x66, 0x70, 0x7e, 0x50,
  0xfc, 0xe0, 0x2e, 0xcb, 0x71, 0x74, 0xf8, 0x9a, 0x9d, 0x9e, 0x5a, 0x20,
  0x8f, 0xbe, 0xe5, 0x0f, 0x14, 0xdf, 0x9b, 0x4f, 0x7f, 0x9e, 0xf1, 0x6c,
  0xa5, 0xe2, 0xf6, 0x48, 0x9c, 0xc3, 0x29, 0x89, 0x49, 0xc6, 0x88, 0x95,
  0xef, 0x44, 0xc4, 0xeb, 0xf0, 0x06, 0xa7, 0xe9, 0xc8, 0x82, 0xdc, 0x4b,
  0xb3, 0x1a, 0x08, 0x30, 0x9a, 0x79, 0xb1, 0x19, 0x1c, 0xc0, 0x35, 0x53,
  0x3d, 0x44, 0x79, 0xa8, 0x30, 0xc0, 0xf7, 0x0d, 0x78, 0x12, 0x1c, 0x78,
  0xe1, 0x8a, 0xf2, 0x72, 0x28, 0x11, 0x6e, 0xe8, 0x6f, 0x9e, 0xd1, 0x4a,
  0xf3, 0xcb, 0x52, 0xf4, 0xa8, 0x23, 0xcb, 0xb5, 0x83, 0x0d, 0xce, 0x29,
  0x6f, 0x5f, 0x36, 0xf8, 0x5a, 0x05, 0xdb, 0x2b, 0xac, 0x2f, 0xa5, 0x6e,
  0xa4, 0x37, 0xe5, 0x8d, 0x5f, 0x25, 0x83, 0xbe, 0xd3, 0xe5, 0xe3, 0x2b,
  0x8c, 0x80, 0x25, 0x50, 0x14, 0x99, 0x0c, 0xac, 0x52, 0xd1, 0xf9, 0x0f,
  0x36, 0x7f, 0x1e, 0x17, 0x59, 0x41, 0x2b, 0x50, 0x8a, 0xdb, 0xa8, 0x55,
  0x69, 0x8b, 0x65, 0xb8, 0x65, 0x03, 0x7a, 0xfa, 0xa2, 0xf8, 0xda, 0x02,
  0x3d, 0xf7, 0x7d, 0x7f, 0xe2, 0x40, 0x7e, 0xd3, 0x79, 0x2b, 0x46, 0x34,
  0xbe, 0x2e, 0xc7, 0xdd, 0xab, 0xe2, 0xd5, 0xf0, 0x51, 0x64, 0x45, 0xdf,
  0x12, 0x6d, 0x28, 0xab, 0x76, 0x21, 0xb4, 0x51, 0xd5, 0x9f, 0xbf, 0x51,
  0xe3, 0xfa, 0x1c, 0xdc, 0x37, 0x48, 0xbf, 0x5e, 0x05, 0x50, 0x3d, 0x48,
  0x98, 0xc2, 0x45, 0x2f, 0xc1, 0xc9, 0xeb, 0x4c, 0x6e, 0x3f, 0x5c, 0x86,
  0x2e, 0xcc, 0xfc, 0x86, 0xc1, 0x02, 0x81, 0x81, 0x00, 0xd0, 0x3f, 0xcc,
  0xc1, 0x59, 0xb0, 0x4a, 0xe2, 0xd7, 0xb5, 0x5f, 0xbb, 0xa7, 0x0a, 0xdf,
  0xa5, 0x98, 0xb8, 0xe1, 0x92, 0x3d, 0xeb, 0x7b, 0x3e, 0xad, 0x54, 0xad,
  0x14, 0xee, 0xb0, 0x7f, 0xd2, 0x39, 0x39, 0x82, 0x39, 0x28, 0x54, 0x7e,
  0x78, 0x85, 0xdc, 0x79, 0xb7, 0x76, 0x01, 0x54, 0x8e, 0x9a, 0xc5, 0xca,
  0x91, 0x36, 0xaa, 0xe3, 0x90, 0x47, 0x9d, 0x6f, 0x89, 0x37, 0x8f, 0xb5,
  0xd1, 0x51, 0x41, 0x04, 0xf0, 0xbb, 0x9c, 0x93, 0x2e, 0x4f, 0x66, 0x8e,
  0xca, 0x0a, 0x55, 0x3d, 0x8d, 0x16, 0xcc, 0x70, 0xdc, 0x9a, 0xd8, 0x03,
  0x7b, 0x43, 0x76, 0xf6, 0x31, 0x9b, 0xa1, 0xd8, 0x7d, 0x95, 0x10, 0xed,
  0x9a, 0xbc, 0xaa, 0xbb, 0xdb, 0xeb, 0xd1, 0x90, 0x69, 0x9d, 0xbb, 0xc4,
  0x25, 0x7d, 0x8d, 0x0a, 0x9e, 0xf7, 0x76, 0x37, 0x93, 0x0b, 0x11, 0x1d,
  0x0e, 0x41, 0x9f, 0x2c, 0x41, 0x02, 0x81, 0x81, 0x00, 0xc3, 0x04, 0x73,
  0x84, 0x82, 0x8a, 0x35, 0x4c, 0x69, 0x38, 0xd6, 0xca, 0xe2, 0xbf, 0xb2,
  0x49, 0x84, 0xb5, 0x46, 0x38, 0xf5, 0xac, 0x5c, 0x05, 0x6a, 0xcb, 0x9f,
  0x61, 0x1d, 0xbc, 0xfb, 0xc0, 0x6c, 0xc8, 0xc9, 0x7d, 0x95, 0x47, 0xa0,
  0x65, 0x79, 0x31, 0xdc, 0x82, 0x11, 0xaa, 0x46, 0x31, 0x3e, 0x02, 0x90,
  0x83, 0x95, 0xc7, 0x01, 0x35, 0xc7, 0x97, 0x52, 0xcc, 0xc9, 0x97, 0xa4,
  0xa4, 0x9f, 0x3e, 0x0e, 0x89, 0x4e, 0xa4, 0x38, 0x04, 0x0d, 0xe3, 0x61,
  0x86, 0x85, 0xa0, 0xe4, 0x92, 0xe5, 0xcc, 0xf2, 0x74, 0xc0, 0x63, 0xc2,
  0x5f, 0xc5, 0xd6, 0x97, 0x1d, 0x9c, 0xc3, 0x2b, 0x67, 0x9e, 0x20, 0x01,
  0x78, 0x34, 0xb9, 0x59, 0x67, 0x14, 0xdd, 0x89, 0x24, 0x80, 0x42, 0x02,
  0x92, 0xde, 0xfc, 0x7b, 0xf6, 0xa4, 0xdc, 0xe3, 0xcb, 0xd1, 0xb4, 0x5f,
  0x2c, 0x77, 0x70, 0xa5, 0x2d, 0x02, 0x81, 0x81, 0x00, 0xb3, 0x10, 0xf9,
  0x1e, 0x94, 0xe1, 0x7b, 0x33, 0x1d, 0x6a, 0x8f, 0x3c, 0x0b, 0x81, 0xd5,
  0x17, 0x4e, 0x80, 0x43, 0x2e, 0x7d, 0xe1, 0xdb, 0x62, 0xe4, 0xa6, 0x38,
  0x02, 0x14, 0xd0, 0x5d, 0xc8, 0xc5, 0x7e, 0x06, 0xd4, 0xe1, 0x31, 0xee,
  0x61, 0xf2, 0x30, 0xc7, 0xd4, 0x92, 0x3a, 0xc8, 0x9b, 0xaa, 0xc8, 0x42,
  0xcb, 0xa4, 0xe7, 0x42, 0xb0, 0x10, 0x74, 0x76, 0xb0, 0xd5, 0xbe, 0xd4,
  0x07, 0x7d, 0xc7, 0xdb, 0xd8, 0xa8, 0x6a, 0x15, 0x40, 0xaf, 0xf3, 0xae,
  0xfa, 0x59, 0xf2, 0x3b, 0xef, 0xf2, 0xd7, 0xae, 0x80, 0x73, 0x01, 0x25,
  0xd5, 0x3b, 0x08, 0xb2, 0xdf, 0xab, 0x44, 0x7a, 0xa4, 0x59, 0xa6, 0x69,
  0xb9, 0x31, 0x5b, 0xda, 0x17, 0x5b, 0xea, 0x22, 0x34, 0x3e, 0xf6, 0x72,
  0xce, 0x0d, 0xec, 0x56, 0x62, 0xa4, 0xc4, 0xd9, 0x3a, 0xae, 0x3c, 0x73,
  0xf0, 0x8b, 0x4a, 0xb4, 0x41, 0x02, 0x81, 0x80, 0x29, 0xc9, 0x9b, 0x63,
  0x2a, 0x81, 0xa8, 0xf8, 0x0d, 0x97, 0xf3, 0x56, 0x98, 0x0d, 0xd1, 0x8b,
  0x35, 0x57, 0x8e, 0x8b, 0x88, 0x00, 0xfd, 0xda, 0xdf, 0x4e, 0x70, 0x81,
  0x63, 0xd8, 0xe9, 0xed, 0x0a, 0xa2, 0x5f, 0xa2, 0x7c, 0x49, 0x53, 0xd2,
  0x4a, 0x8c, 0xe7, 0x9e, 0x2b, 0x60, 0xdc, 0x17, 0x93, 0x1d, 0x03, 0x90,
  0x5e, 0x98, 0xbc, 0xe6, 0xa4, 0x35, 0x05, 0xb6, 0x02, 0x00, 0x6f, 0x74,
  0x22, 0xf7, 0x2e, 0x30, 0x37, 0xdc, 0xb2, 0x70, 0x13, 0xf5, 0xc4, 0x21,
  0x0a, 0x23, 0x36, 0xb7, 0x4f, 0x6c, 0x82, 0x0b, 0x88, 0x6a, 0x17, 0xed,
  0x63, 0xbc, 0x1e, 0xb7, 0x66, 0xae, 0xdf, 0x6f, 0x1d, 0x8f, 0xe8, 0x20,
  0xb4, 0xd3, 0x7e, 0x97, 0xba, 0xfd, 0xd9, 0x74, 0x2b, 0xd3, 0x79, 0x2f,
  0xb5, 0x7e, 0x4e, 0xa5, 0xc4, 0x1f, 0xdc, 0xe4, 0x00, 0xb4, 0x70, 0xac,
  0x5b, 0x8f, 0x94, 0xa5, 0x02, 0x81, 0x80, 0x08, 0xec, 0x1a, 0x88, 0x7f,
  0x2f, 0xbc, 0xe2, 0x6f, 0xa1, 0xcb, 0xb0, 0x24, 0xd0, 0x8c, 0x1c, 0x98,
  0xe9, 0xe3, 0x46, 0xab, 0xa7, 0xd8, 0x8f, 0x95, 0xb6, 0xa6, 0x94, 0x5b,
  0xbd, 0x8e, 0x3d, 0x7b, 0x17, 0x5d, 0x0f, 0x92, 0x45, 0x9c, 0x08, 0x9e,
  0xce, 0x26, 0xa6, 0x5e, 0x70, 0x6f, 0xd8, 0xfc, 0x37, 0xb1, 0x4b, 0xc3,
  0x52, 0x60, 0xc2, 0x5a, 0x58, 0x65, 0x3a, 0xd4, 0xd8, 0xf6, 0x9e, 0xab,
  0x8f, 0xd8, 0x3e, 0x07, 0xd9, 0x67, 0xe9, 0x8f, 0xf8, 0xdf, 0xa1, 0x9c,
  0x16, 0xf3, 0x6a, 0xc2, 0x5a, 0xae, 0x07, 0xf6, 0xc8, 0xd4, 0xdb, 0x0a,
  0x61, 0x3d, 0xec, 0xd2, 0x16, 0x76, 0x6a, 0x2c, 0xab, 0x5c, 0x75, 0xf7,
  0x38, 0x9d, 0x18, 0xbc, 0xd1, 0x86, 0xd2, 0x74, 0xc9, 0xc9, 0x34, 0x54,
  0x9f, 0x47, 0x20, 0x6a, 0x58, 0xee, 0xc6, 0x66, 0x63, 0xa4, 0xcf, 0x60,
  0x18, 0x04, 0x51
};
```
