## CMakeLists.txt
```
cmake_minimum_required(VERSION 3.20)

find_package(Zephyr REQUIRED HINTS $ENV{ZEPHYR_BASE})
project(gui_demo)

target_sources(app PRIVATE src/main.c src/gui.c)
target_include_directories(app PRIVATE src)
```

## prj.conf
```kconfig
# ── Core ──────────────────────────────────────────────────────────────────
CONFIG_XIP=n
CONFIG_CBPRINTF_FP_SUPPORT=n
CONFIG_CBPRINTF_FP_A_SUPPORT=n

# ── UART console ──────────────────────────────────────────────────────────
CONFIG_UART_KLAUSSCPU=y
CONFIG_UART_CONSOLE=y
CONFIG_CONSOLE=y
CONFIG_PRINTK=y

# ── Timer (1 kHz tick) ────────────────────────────────────────────────────
CONFIG_KLAUSSCPU_TIMER=y
CONFIG_SYS_CLOCK_HW_CYCLES_PER_SEC=100000000
CONFIG_SYS_CLOCK_TICKS_PER_SEC=1000

# ── Networking (for the VNC link) ─────────────────────────────────────────
CONFIG_NETWORKING=y
CONFIG_NET_L2_ETHERNET=y
CONFIG_ETH_KLAUSSCPU=y
CONFIG_NET_IPV4=y
CONFIG_NET_IPV6=n
CONFIG_NET_DHCPV4=y
CONFIG_NET_SOCKETS=y
CONFIG_NET_TCP=y
CONFIG_NET_UDP=y
# 64-bit frames need real headroom on the net threads (see ssh_shell rationale).
CONFIG_NET_RX_STACK_SIZE=8192
CONFIG_NET_TX_STACK_SIZE=8192
CONFIG_NET_SOCKETS_SERVICE_STACK_SIZE=8192
CONFIG_NET_MGMT_EVENT_STACK_SIZE=8192
CONFIG_NET_TCP_WORKQ_STACK_SIZE=8192
CONFIG_STACK_SENTINEL=y
CONFIG_NET_PKT_RX_COUNT=64
CONFIG_NET_PKT_TX_COUNT=48
CONFIG_NET_BUF_RX_COUNT=96
CONFIG_NET_BUF_TX_COUNT=64
CONFIG_NET_BUF_DATA_SIZE=1536
CONFIG_NET_MAX_CONTEXTS=24
CONFIG_NET_MAX_CONN=24
CONFIG_ZVFS_OPEN_MAX=16

# ── VNC (RFB) server — the GUI owns the framebuffer, so no built-in demo ──
CONFIG_KLAUSSCPU_VNC_SERVER=y
CONFIG_KLAUSSCPU_VNC_DEMO=n

# ── Logging (the VNC module uses the log subsystem; immediate avoids the
#    deferred-packaging vararg corruption seen on this core) ───────────────
CONFIG_LOG=y
CONFIG_LOG_BACKEND_UART=y
CONFIG_LOG_MODE_IMMEDIATE=y
CONFIG_THREAD_NAME=y

# ── Memory ────────────────────────────────────────────────────────────────
CONFIG_MAIN_STACK_SIZE=16384
CONFIG_SYSTEM_WORKQUEUE_STACK_SIZE=8192

# KlaussCPU VGA port: also show the framebuffer on a monitor (KlaussCPU VGA_PLAN.md).
CONFIG_KLAUSSCPU_VGA=y
```

## src/main.c
```c
/*
 * main.c — minimal hand-rolled GUI over VNC for KlaussCPU.
 *
 * Draws a little control panel into the in-RAM framebuffer and serves it over
 * VNC.  Clicking the buttons (VNC PointerEvent) changes a counter and a colour
 * swatch; an uptime field ticks once a second.  Only the touched regions are
 * redrawn + marked dirty, so updates are tiny and snappy — the workload VNC is
 * actually good at (cf. vnc/PERFORMANCE.md).
 */

#include <zephyr/kernel.h>
#include <zephyr/logging/log.h>
#include <zephyr/net/net_if.h>
#include <zephyr/net/net_mgmt.h>
#include <zephyr/net/net_ip.h>
#include <zephyr/net/dhcpv4.h>
#include <stdio.h>

#include "framebuffer.h"
#include "vnc_server.h"
#include "gui.h"

LOG_MODULE_REGISTER(gui, LOG_LEVEL_INF);

/* Compile-time RGB565 (fb_rgb is not a constant expression). */
#define RGB(r, g, b) ((uint16_t)((((r) & 0xF8) << 8) | (((g) & 0xFC) << 3) | ((b) >> 3)))

#define C_BG     RGB(18, 22, 38)
#define C_TITLE  RGB(40, 90, 170)
#define C_PANEL  RGB(28, 32, 52)
#define C_TEXT   RGB(230, 232, 245)
#define C_DIM    RGB(150, 155, 180)
#define C_ACCENT RGB(255, 200, 60)

/* ── widget state ───────────────────────────────────────────────────────── */

static int counter;
static int color_idx;
static const uint16_t swatches[] = {
	RGB(220, 60, 60), RGB(60, 200, 90), RGB(70, 120, 240),
	RGB(240, 200, 50), RGB(200, 90, 220), RGB(40, 210, 210),
};
#define NSWATCH ((int)(sizeof(swatches) / sizeof(swatches[0])))

/* Layout constants. */
#define COUNT_X   40
#define COUNT_Y   120
#define SWATCH_X  40
#define SWATCH_Y  330
#define SWATCH_W  220
#define SWATCH_H  90
#define UP_X      320
#define UP_Y      360

static void draw_counter(void)
{
	char buf[16];

	(void)snprintf(buf, sizeof(buf), "%d", counter);
	gui_fill(COUNT_X, COUNT_Y, 260, 8 * 7, C_PANEL);   /* erase old value */
	gui_text(COUNT_X, COUNT_Y, buf, C_ACCENT, 7);
}

static void draw_swatch(void)
{
	gui_fill(SWATCH_X, SWATCH_Y, SWATCH_W, SWATCH_H, swatches[color_idx]);
	gui_border(SWATCH_X, SWATCH_Y, SWATCH_W, SWATCH_H, 3, C_TEXT);
}

static void draw_uptime(void)
{
	char buf[24];
	uint32_t s = (uint32_t)(k_uptime_get() / 1000);

	(void)snprintf(buf, sizeof(buf), "UPTIME: %u S", s);
	gui_fill(UP_X, UP_Y, 280, 8 * 3, C_PANEL);
	gui_text(UP_X, UP_Y, buf, C_DIM, 3);
}

/* ── button actions ─────────────────────────────────────────────────────── */

static void act_inc(void)   { counter++;  draw_counter(); }
static void act_dec(void)   { counter--;  draw_counter(); }
static void act_reset(void) { counter = 0; draw_counter(); }
static void act_color(void) { color_idx = (color_idx + 1) % NSWATCH; draw_swatch(); }

static const struct gui_button buttons[] = {
	{ .x =  40, .y = 240, .w =  90, .h = 64, .label = "-",     .action = act_dec   },
	{ .x = 150, .y = 240, .w =  90, .h = 64, .label = "+",     .action = act_inc   },
	{ .x = 270, .y = 240, .w = 150, .h = 64, .label = "RESET", .action = act_reset },
	{ .x = 440, .y = 240, .w = 160, .h = 64, .label = "COLOR", .action = act_color },
};
#define NBTN ((int)(sizeof(buttons) / sizeof(buttons[0])))

static void build_gui(void)
{
	gui_fill(0, 0, FB_WIDTH, FB_HEIGHT, C_BG);
	gui_fill(0, 0, FB_WIDTH, 46, C_TITLE);
	gui_text(16, 11, "KLAUSSCPU VNC DEMO", C_TEXT, 3);

	gui_text(COUNT_X, 90, "COUNT", C_DIM, 2);
	draw_counter();

	for (int i = 0; i < NBTN; i++) {
		gui_button_draw(&buttons[i], false);
	}

	gui_text(SWATCH_X, SWATCH_Y - 24, "COLOR SWATCH", C_DIM, 2);
	draw_swatch();
	draw_uptime();

	gui_text(40, 450, "CLICK THE BUTTONS WITH YOUR MOUSE", C_DIM, 1);
}

/* ── VNC pointer input (runs on the VNC thread) ─────────────────────────── */

static int  pressed_idx = -1;
static bool prev_down;

static void on_pointer(uint16_t x, uint16_t y, uint8_t buttons_mask)
{
	bool down = buttons_mask & 1;   /* left button */

	if (down && !prev_down) {
		for (int i = 0; i < NBTN; i++) {
			if (gui_button_hit(&buttons[i], x, y)) {
				pressed_idx = i;
				gui_button_draw(&buttons[i], true);
				if (buttons[i].action) {
					buttons[i].action();
				}
				break;
			}
		}
	} else if (!down && prev_down && pressed_idx >= 0) {
		gui_button_draw(&buttons[pressed_idx], false);
		pressed_idx = -1;
	}
	prev_down = down;
}

/* ── DHCP ───────────────────────────────────────────────────────────────── */

static struct net_mgmt_event_callback dhcp_cb;
static struct k_sem dhcp_sem;

static void dhcp_handler(struct net_mgmt_event_callback *cb,
			 uint64_t mgmt_event, struct net_if *iface)
{
	ARG_UNUSED(cb);
	ARG_UNUSED(iface);
	if (mgmt_event == NET_EVENT_IPV4_DHCP_BOUND) {
		k_sem_give(&dhcp_sem);
	}
}

static void wait_for_dhcp(void)
{
	k_sem_init(&dhcp_sem, 0, 1);
	net_mgmt_init_event_callback(&dhcp_cb, dhcp_handler,
				     NET_EVENT_IPV4_DHCP_BOUND);
	net_mgmt_add_event_callback(&dhcp_cb);

	struct net_if *iface = net_if_get_default();

	if (!iface) {
		LOG_ERR("no network interface");
		return;
	}
	net_dhcpv4_start(iface);
	if (k_sem_take(&dhcp_sem, K_SECONDS(10)) != 0) {
		LOG_WRN("DHCP timeout — VNC will be unreachable");
	}
}

/* ── uptime ticker ──────────────────────────────────────────────────────── */

#define TICK_STACK 2048
static K_THREAD_STACK_DEFINE(tick_stack, TICK_STACK);
static struct k_thread tick_thread;

static void tick_entry(void *a, void *b, void *c)
{
	ARG_UNUSED(a);
	ARG_UNUSED(b);
	ARG_UNUSED(c);
	for (;;) {
		draw_uptime();
		k_sleep(K_SECONDS(1));
	}
}

int main(void)
{
	printk("\nKlaussCPU VNC GUI demo\n");

	wait_for_dhcp();

	build_gui();
	vnc_register_input(NULL, on_pointer);
	vnc_server_start();
	LOG_INF("VNC GUI ready on port 5900");

	k_thread_create(&tick_thread, tick_stack, TICK_STACK,
			tick_entry, NULL, NULL, NULL, 10, 0, K_NO_WAIT);
	k_thread_name_set(&tick_thread, "uptime");

	/* Don't return from main on this arch (jumps to a null return address). */
	k_sleep(K_FOREVER);
	return 0;
}
```

## src/font8x8.h
```c
/*
 * font8x8.h — tiny 5x7-in-8x8 bitmap font for the VNC GUI demo.
 *
 * Covers ASCII 0x20..0x5A (space, a few symbols, digits, uppercase A-Z);
 * lowercase is folded to uppercase, anything else renders blank.  Each glyph is
 * 8 rows; bit 0x80 is the leftmost pixel.  Self-authored, public domain.
 */
#ifndef GUI_FONT8X8_H_
#define GUI_FONT8X8_H_

#include <stdint.h>

#define FONT_FIRST 0x20
#define FONT_LAST  0x5A

static const uint8_t font8x8[FONT_LAST - FONT_FIRST + 1][8] = {
	[0x20 - 0x20] = { 0, 0, 0, 0, 0, 0, 0, 0 },                       /* space */
	[0x25 - 0x20] = { 0xC8, 0xD0, 0x10, 0x20, 0x40, 0xB0, 0x98, 0 },  /* %     */
	[0x2B - 0x20] = { 0x00, 0x20, 0x20, 0xF8, 0x20, 0x20, 0x00, 0 },  /* +     */
	[0x2D - 0x20] = { 0x00, 0x00, 0x00, 0xF8, 0x00, 0x00, 0x00, 0 },  /* -     */
	[0x2E - 0x20] = { 0x00, 0x00, 0x00, 0x00, 0x00, 0x60, 0x60, 0 },  /* .     */
	[0x2F - 0x20] = { 0x08, 0x10, 0x10, 0x20, 0x40, 0x40, 0x80, 0 },  /* /     */
	[0x30 - 0x20] = { 0x70, 0x88, 0x98, 0xA8, 0xC8, 0x88, 0x70, 0 },  /* 0     */
	[0x31 - 0x20] = { 0x20, 0x60, 0x20, 0x20, 0x20, 0x20, 0x70, 0 },  /* 1     */
	[0x32 - 0x20] = { 0x70, 0x88, 0x08, 0x10, 0x20, 0x40, 0xF8, 0 },  /* 2     */
	[0x33 - 0x20] = { 0xF0, 0x08, 0x08, 0x70, 0x08, 0x08, 0xF0, 0 },  /* 3     */
	[0x34 - 0x20] = { 0x10, 0x30, 0x50, 0x90, 0xF8, 0x10, 0x10, 0 },  /* 4     */
	[0x35 - 0x20] = { 0xF8, 0x80, 0xF0, 0x08, 0x08, 0x88, 0x70, 0 },  /* 5     */
	[0x36 - 0x20] = { 0x70, 0x80, 0x80, 0xF0, 0x88, 0x88, 0x70, 0 },  /* 6     */
	[0x37 - 0x20] = { 0xF8, 0x08, 0x10, 0x20, 0x40, 0x40, 0x40, 0 },  /* 7     */
	[0x38 - 0x20] = { 0x70, 0x88, 0x88, 0x70, 0x88, 0x88, 0x70, 0 },  /* 8     */
	[0x39 - 0x20] = { 0x70, 0x88, 0x88, 0x78, 0x08, 0x08, 0x70, 0 },  /* 9     */
	[0x3A - 0x20] = { 0x00, 0x60, 0x60, 0x00, 0x60, 0x60, 0x00, 0 },  /* :     */
	[0x41 - 0x20] = { 0x70, 0x88, 0x88, 0xF8, 0x88, 0x88, 0x88, 0 },  /* A     */
	[0x42 - 0x20] = { 0xF0, 0x88, 0x88, 0xF0, 0x88, 0x88, 0xF0, 0 },  /* B     */
	[0x43 - 0x20] = { 0x70, 0x88, 0x80, 0x80, 0x80, 0x88, 0x70, 0 },  /* C     */
	[0x44 - 0x20] = { 0xE0, 0x90, 0x88, 0x88, 0x88, 0x90, 0xE0, 0 },  /* D     */
	[0x45 - 0x20] = { 0xF8, 0x80, 0x80, 0xF0, 0x80, 0x80, 0xF8, 0 },  /* E     */
	[0x46 - 0x20] = { 0xF8, 0x80, 0x80, 0xF0, 0x80, 0x80, 0x80, 0 },  /* F     */
	[0x47 - 0x20] = { 0x70, 0x88, 0x80, 0xB8, 0x88, 0x88, 0x70, 0 },  /* G     */
	[0x48 - 0x20] = { 0x88, 0x88, 0x88, 0xF8, 0x88, 0x88, 0x88, 0 },  /* H     */
	[0x49 - 0x20] = { 0x70, 0x20, 0x20, 0x20, 0x20, 0x20, 0x70, 0 },  /* I     */
	[0x4A - 0x20] = { 0x38, 0x10, 0x10, 0x10, 0x90, 0x90, 0x60, 0 },  /* J     */
	[0x4B - 0x20] = { 0x88, 0x90, 0xA0, 0xC0, 0xA0, 0x90, 0x88, 0 },  /* K     */
	[0x4C - 0x20] = { 0x80, 0x80, 0x80, 0x80, 0x80, 0x80, 0xF8, 0 },  /* L     */
	[0x4D - 0x20] = { 0x88, 0xD8, 0xA8, 0xA8, 0x88, 0x88, 0x88, 0 },  /* M     */
	[0x4E - 0x20] = { 0x88, 0xC8, 0xA8, 0xA8, 0x98, 0x88, 0x88, 0 },  /* N     */
	[0x4F - 0x20] = { 0x70, 0x88, 0x88, 0x88, 0x88, 0x88, 0x70, 0 },  /* O     */
	[0x50 - 0x20] = { 0xF0, 0x88, 0x88, 0xF0, 0x80, 0x80, 0x80, 0 },  /* P     */
	[0x51 - 0x20] = { 0x70, 0x88, 0x88, 0x88, 0xA8, 0x90, 0x68, 0 },  /* Q     */
	[0x52 - 0x20] = { 0xF0, 0x88, 0x88, 0xF0, 0xA0, 0x90, 0x88, 0 },  /* R     */
	[0x53 - 0x20] = { 0x70, 0x88, 0x80, 0x70, 0x08, 0x88, 0x70, 0 },  /* S     */
	[0x54 - 0x20] = { 0xF8, 0x20, 0x20, 0x20, 0x20, 0x20, 0x20, 0 },  /* T     */
	[0x55 - 0x20] = { 0x88, 0x88, 0x88, 0x88, 0x88, 0x88, 0x70, 0 },  /* U     */
	[0x56 - 0x20] = { 0x88, 0x88, 0x88, 0x88, 0x88, 0x50, 0x20, 0 },  /* V     */
	[0x57 - 0x20] = { 0x88, 0x88, 0x88, 0xA8, 0xA8, 0xD8, 0x88, 0 },  /* W     */
	[0x58 - 0x20] = { 0x88, 0x88, 0x50, 0x20, 0x50, 0x88, 0x88, 0 },  /* X     */
	[0x59 - 0x20] = { 0x88, 0x88, 0x50, 0x20, 0x20, 0x20, 0x20, 0 },  /* Y     */
	[0x5A - 0x20] = { 0xF8, 0x08, 0x10, 0x20, 0x40, 0x80, 0xF8, 0 },  /* Z     */
};

static inline const uint8_t *font_glyph(char c)
{
	static const uint8_t blank[8] = { 0 };

	if (c >= 'a' && c <= 'z') {
		c -= 32;   /* fold lowercase to uppercase */
	}
	if (c < FONT_FIRST || c > FONT_LAST) {
		return blank;
	}
	return font8x8[c - FONT_FIRST];
}

#endif /* GUI_FONT8X8_H_ */
```

## src/gui.c
```c
/*
 * gui.c — minimal widget drawing on top of the VNC framebuffer primitives.
 */
#include <string.h>

#include "framebuffer.h"
#include "gui.h"
#include "font8x8.h"

void gui_fill(int x, int y, int w, int h, uint16_t color)
{
	fb_fill_rect(x, y, w, h, color);
}

void gui_border(int x, int y, int w, int h, int thick, uint16_t color)
{
	fb_fill_rect(x, y, w, thick, color);             /* top    */
	fb_fill_rect(x, y + h - thick, w, thick, color); /* bottom */
	fb_fill_rect(x, y, thick, h, color);             /* left   */
	fb_fill_rect(x + w - thick, y, thick, h, color); /* right  */
}

void gui_text(int x, int y, const char *s, uint16_t fg, int scale)
{
	int x0 = x;

	fb_lock();
	uint16_t *fb = fb_pixels();

	for (; *s; s++) {
		const uint8_t *g = font_glyph(*s);

		for (int row = 0; row < 8; row++) {
			uint8_t bits = g[row];

			while (bits) {
				int col = __builtin_clz((unsigned)bits) - 24;
				int px0 = x + col * scale;
				int py0 = y + row * scale;

				for (int dy = 0; dy < scale; dy++) {
					for (int dx = 0; dx < scale; dx++) {
						int px = px0 + dx, py = py0 + dy;

						if ((unsigned)px < FB_WIDTH &&
						    (unsigned)py < FB_HEIGHT) {
							fb[(size_t)py * FB_WIDTH + px] = fg;
						}
					}
				}
				bits &= ~(0x80u >> col);
			}
		}
		x += 6 * scale;
	}
	fb_unlock();
	fb_mark_dirty(x0, y, x - x0, 8 * scale);
}

void gui_button_draw(const struct gui_button *b, bool pressed)
{
	uint16_t face = pressed ? fb_rgb(90, 90, 150) : fb_rgb(55, 60, 95);

	gui_fill(b->x, b->y, b->w, b->h, face);
	gui_border(b->x, b->y, b->w, b->h, 2, fb_rgb(170, 180, 230));

	int sc = 2;
	int tw = (int)strlen(b->label) * 6 * sc;
	int tx = b->x + (b->w - tw) / 2;
	int ty = b->y + (b->h - 8 * sc) / 2;

	gui_text(tx, ty, b->label, fb_rgb(255, 255, 255), sc);
}

bool gui_button_hit(const struct gui_button *b, int px, int py)
{
	return px >= b->x && px < b->x + b->w && py >= b->y && py < b->y + b->h;
}
```

## src/gui.h
```c
/*
 * gui.h — minimal immediate-mode-ish widgets drawn into the VNC framebuffer.
 */
#ifndef GUI_H_
#define GUI_H_

#include <stdint.h>
#include <stdbool.h>

/* Filled text at (x,y), `scale`x integer-scaled 8x8 glyphs (5px wide each). */
void gui_text(int x, int y, const char *s, uint16_t fg, int scale);

/* Solid rectangle. */
void gui_fill(int x, int y, int w, int h, uint16_t color);

/* `thick`-pixel rectangle outline. */
void gui_border(int x, int y, int w, int h, int thick, uint16_t color);

struct gui_button {
	int x, y, w, h;
	const char *label;
	void (*action)(void);
};

void gui_button_draw(const struct gui_button *b, bool pressed);
bool gui_button_hit(const struct gui_button *b, int px, int py);

#endif /* GUI_H_ */
```
