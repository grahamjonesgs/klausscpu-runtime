## CMakeLists.txt
```
cmake_minimum_required(VERSION 3.20)
find_package(Zephyr REQUIRED HINTS $ENV{ZEPHYR_BASE})
project(klausscpu_llext_demo)

target_sources(app PRIVATE src/main.c)

# The extension is compiled from ext/hello_ext.c at build time, with the same
# compiler as the kernel, into an ELFCLASS32 ET_REL object (the flags of the
# bare-metal Makefile's %.llext rule, long calls included), and embedded in
# main.c as a byte array.
# Building it here keeps its code in step with the toolchain's instruction
# encoding; a checked-in prebuilt image went stale when the ISA changed.
set(HELLO_EXT_SRC ${CMAKE_CURRENT_SOURCE_DIR}/ext/hello_ext.c)
set(HELLO_EXT_OBJ ${CMAKE_CURRENT_BINARY_DIR}/hello_ext.llext)
add_custom_command(
  OUTPUT ${HELLO_EXT_OBJ}
  COMMAND ${CMAKE_C_COMPILER} --target=${CMAKE_C_COMPILER_TARGET}
          -Os -nostdinc -ffreestanding -fno-builtin
          -mllvm -klausscpu-short-calls=false
          -c ${HELLO_EXT_SRC} -o ${HELLO_EXT_OBJ}
  DEPENDS ${HELLO_EXT_SRC}
  COMMENT "Building LLEXT extension hello_ext.llext"
)
generate_inc_file_for_target(app ${HELLO_EXT_OBJ}
  ${ZEPHYR_BINARY_DIR}/include/generated/hello_ext.inc)
```

## prj.conf
```kconfig
# ── Core ──────────────────────────────────────────────────────────────────
CONFIG_XIP=n
CONFIG_CBPRINTF_FP_SUPPORT=n
CONFIG_CBPRINTF_FP_A_SUPPORT=n

# ── UART console ──────────────────────────────────────────────────────────
CONFIG_UART_KLAUSSCPU=y
CONFIG_UART_CONSOLE=y
CONFIG_PRINTK=y

# ── Timer ─────────────────────────────────────────────────────────────────
CONFIG_KLAUSSCPU_TIMER=y
CONFIG_SYS_CLOCK_HW_CYCLES_PER_SEC=100000000

# ── LLEXT (linkable loadable extensions) ─────────────────────────────────
CONFIG_LLEXT=y
CONFIG_LLEXT_TYPE_ELF_OBJECT=y
CONFIG_LLEXT_HEAP_SIZE=64

# ── Memory ────────────────────────────────────────────────────────────────
CONFIG_HEAP_MEM_POOL_SIZE=131072
CONFIG_MAIN_STACK_SIZE=8192
```

## src/main.c
```c
/*
 * KlaussCPU LLEXT demo — loads an embedded ELFCLASS32 extension from RAM,
 * resolves and calls hello_world(), then unloads it.
 *
 * This exercises the full llext path on KlaussCPU:
 *   - ELF32 parsing under CONFIG_64BIT=y (CONFIG_LLEXT_ELF_CLASS32)
 *   - SHT_RELA relocation handling (llext_link.c generic path)
 *   - arch_elf_relocate() in arch/klausscpu/core/elf.c (ABS32/ABS64/PCREL32)
 *   - kernel symbol export resolution (EXPORT_SYMBOL(printk))
 */
#include <zephyr/kernel.h>
#include <zephyr/llext/llext.h>
#include <zephyr/llext/buf_loader.h>
#include <zephyr/llext/symbol.h>

/* ext/hello_ext.c, compiled at build time (see CMakeLists.txt). */
static const unsigned char __aligned(8) hello_ext_bin[] = {
#include "hello_ext.inc"
};

/* The extension references printk; expose it to the loader's symbol table. */
EXPORT_SYMBOL(printk);

int main(void)
{
	printk("=== KlaussCPU LLEXT demo ===\n");
	printk("extension image: %u bytes\n", (unsigned int)sizeof(hello_ext_bin));

	struct llext_buf_loader buf_loader =
		LLEXT_BUF_LOADER(hello_ext_bin, sizeof(hello_ext_bin));
	struct llext_loader *ldr = &buf_loader.loader;
	struct llext_load_param ldr_parm = LLEXT_LOAD_PARAM_DEFAULT;
	struct llext *ext = NULL;

	/* Keep ext->sym_tab after load so llext_find_sym() can resolve by name. */
	ldr_parm.keep_symtab = true;

	int ret = llext_load(ldr, "hello", &ext, &ldr_parm);

	if (ret != 0) {
		printk("llext_load FAILED: %d\n", ret);
		return 0;
	}
	printk("llext_load OK (ext=%p)\n", (void *)ext);

	void (*fn)(void) =
		(void (*)(void))llext_find_sym(&ext->sym_tab, "hello_world");

	if (fn == NULL) {
		printk("symbol 'hello_world' not found in extension\n");
	} else {
		printk("calling hello_world @ %p\n", (void *)fn);
		fn();
		fn();
	}

	ret = llext_unload(&ext);
	printk("llext_unload: %d\n", ret);
	printk("=== LLEXT demo done ===\n");
	return 0;
}
```
